## Documentation/devicetree/bindings/pinctrl/marvell,pxa2xx-pinctrl.yaml
```yaml
# SPDX-License-Identifier: (GPL-2.0-only OR BSD-2-Clause)
%YAML 1.2
---
$id: http://devicetree.org/schemas/pinctrl/marvell,pxa2xx-pinctrl.yaml#
$schema: http://devicetree.org/meta-schemas/core.yaml#

title: Marvell PXA25x and PXA27x pin controller

maintainers:
  - Koen Kooi <koen@dominion.thruhere.net>

description: >
  Pin multiplexing and sleep state control of the general purpose I/O pads of
  the Marvell (formerly Intel) PXA25x and PXA27x application processors.

  Every pad is a GPIO that can be handed over to up to three alternate
  peripheral functions. A two-bit field of the GPIO alternate function
  registers (GAFR) selects the function, one bit of the GPIO pin direction
  registers (GPDR) selects the direction, and one bit of the power manager's
  GPIO sleep state registers (PGSR) holds the level an output pad is driven to
  while the SoC is in sleep mode. The GAFR and GPDR registers lie inside the
  register block of the GPIO controller and are shared with it.

  The pads are named after their GPIO number, "P" followed by the number. The
  PXA25x controller manages P0 to P84, the PXA27x controller manages P0, P1
  and P9 to P120. Each pad is a group of its own, named like the pad.

properties:
  compatible:
    enum:
      - marvell,pxa25x-pinctrl
      - marvell,pxa27x-pinctrl

  reg:
    items:
      - description:
          GPIO alternate function registers GAFR0_L to GAFR3_U, of which the
          PXA25x implements GAFR0_L to GAFR2_U
      - description: GPIO pin direction registers GPDR0 to GPDR2
      - description:
          GPIO pin direction register GPDR3, which holds the direction bits of
          the pads above P95; unused on the PXA25x
      - description:
          Power manager GPIO sleep state registers PGSR0 to PGSR3, of which
          the PXA25x implements PGSR0 to PGSR2

patternProperties:
  "-pins$":
    description:
      Pin configuration selected by a consumer through its pinctrl-N
      property. It is either a single node that lists the pads and what to
      do with them, or a node without a configuration of its own that groups
      several such nodes; the pads of every node directly below it are
      configured together.
    oneOf:
      - $ref: "#/$defs/pins-node"

      - type: object
        description:
          Groups the pin configuration nodes that belong to one state.
        patternProperties:
          "-pins$":
            $ref: "#/$defs/pins-node"
        additionalProperties: false

$defs:
  pins-node:
    type: object
    description:
      Pin configuration of a set of pads.
    allOf:
      - $ref: pincfg-node.yaml#
      - $ref: pinmux-node.yaml#
    additionalProperties: false

    properties:
      groups:
        description:
          Names of the pads to configure, "P<n>" for GPIO n.
        minItems: 1
        maxItems: 114

      function:
        description:
          Function to select on the pads. Either gpio_in or gpio_out for a
          plain GPIO with the given direction, or the alternate function of
          the pads, named after the signal in the SoC manual's alternate
          function table. Where two units share a signal name the name carries
          the unit as a prefix (AC97_SYNC, I2S_SYNC), and where one pad offers
          the same signal both as an input and as an output the name carries
          an _IN or _OUT suffix (I2S_BITCLK_IN, I2S_BITCLK_OUT). A pad only
          accepts its own alternate functions.

      low-power-enable:
        description:
          Drive the pads high while the SoC is in sleep mode, if they are
          outputs.

      low-power-disable:
        description:
          Drive the pads low while the SoC is in sleep mode, if they are
          outputs.

    required:
      - groups

    anyOf:
      - required:
          - function
      - required:
          - low-power-enable
      - required:
          - low-power-disable

  pxa25x-pins:
    properties:
      groups:
        maxItems: 85
        items:
          pattern: "^P([0-9]|[1-7][0-9]|8[0-4])$"

      function:
        enum: [gpio_in, gpio_out, 3_6_MHz, 32_kHz, 48_MHz, AC97_BITCLK,
               AC97_SDATA_IN_0, AC97_SDATA_IN_1, AC97_SDATA_OUT, AC97_SYNC,
               BTCTS, BTRTS, BTRXD, BTTXD, CTS, DCD, "DREQ[0]", "DREQ[1]", DSR,
               DTR, EXTCLK, FFRXD, FFTXD, GP_RST, HWCTS, HWRTS, HWRXD, HWTXD,
               I2S_BITCLK_IN, I2S_BITCLK_OUT, I2S_SDATA_IN, I2S_SDATA_OUT,
               I2S_SYNC, I2S_SYSCLK, ICP_RXD, ICP_TXD, LCD_ACBIAS, LCD_FCLK,
               LCD_LCLK, LCD_PCLK, LDD<0>, LDD<1>, LDD<2>, LDD<3>, LDD<4>,
               LDD<5>, LDD<6>, LDD<7>, LDD<8>, LDD<9>, LDD<10>, LDD<11>,
               LDD<12>, LDD<13>, LDD<14>, LDD<15>, MBGNT, MBREQ, MMCC1, MMCCLK,
               MMCCS0, MMCCS1, nCS<2>, nCS<3>, nCS<4>, "nCS[5]", nCS_1,
               nIOIS16, "nPCE[1]", "nPCE[2]", nPIOR, nPIOW, nPOE, nPREG,
               nPSKTSEL, nPWAIT, nPWE, NSSPRXD, NSSPSCLK_IN, NSSPSCLK_OUT,
               NSSPSFRM_IN, NSSPSFRM_OUT, NSSPTXD, PWM0, PWM1, RDY, RI, RTCCLK,
               RTS, RXD, SCLK, SFRM, TXD]

  pxa27x-pins:
    properties:
      groups:
        items:
          pattern: "^P([01]|9|[1-9][0-9]|1[01][0-9]|120)$"

      function:
        enum: [gpio_in, gpio_out, 48_MHz, AC97_BITCLK, AC97_RESET_n,
               AC97_SDATA_IN_0, AC97_SDATA_IN_1, AC97_SDATA_OUT,
               AC97_SYNC, AC97_SYSCLK, BB_IB_CLK, BB_IB_DAT<0>,
               BB_IB_DAT<1>, BB_IB_DAT<2>, BB_IB_DAT<3>, BB_IB_STB,
               BB_IB_WAIT, BB_OB_CLK, BB_OB_DAT<0>, BB_OB_DAT<1>,
               BB_OB_DAT<2>, BB_OB_DAT<3>, BB_OB_STB, BB_OB_WAIT, BTCTS,
               BTRTS, BTRXD, BTTXD, CHOUT<0>, CHOUT<1>, CIF_DD<0>,
               CIF_DD<1>, CIF_DD<2>, CIF_DD<3>, CIF_DD<4>, CIF_DD<5>,
               CIF_DD<6>, CIF_DD<7>, CIF_DD<8>, CIF_DD<9>, CIF_FV, CIF_LV,
               CIF_MCLK, CIF_PCLK, CLK_EXT, DREQ<0>, DREQ<1>, DREQ<2>,
               DVAL<0>, DVAL<1>, EXT_SYNC<0>, EXT_SYNC<1>, FFCTS, FFDCD,
               FFDSR, FFDTR, FFRI, FFRTS, FFRXD, FFTXD, HZ_CLK,
               I2S_BITCLK, I2S_SDATA_IN, I2S_SDATA_OUT, I2S_SYNC,
               I2S_SYSCLK, ICP_RXD, ICP_TXD, KP_DKIN<0>, KP_DKIN<1>,
               KP_DKIN<2>, KP_DKIN<3>, KP_DKIN<4>, KP_DKIN<5>, KP_DKIN<6>,
               KP_DKIN<7>, KP_MKIN<0>, KP_MKIN<1>, KP_MKIN<2>, KP_MKIN<3>,
               KP_MKIN<4>, KP_MKIN<5>, KP_MKIN<6>, KP_MKIN<7>,
               KP_MKOUT<0>, KP_MKOUT<1>, KP_MKOUT<2>, KP_MKOUT<3>,
               KP_MKOUT<4>, KP_MKOUT<5>, KP_MKOUT<6>, KP_MKOUT<7>, L_BIAS,
               L_CS, L_FCLK_RD, L_LCLK_A0, L_PCLK_WR, L_VSYNC, LDD<0>,
               LDD<1>, LDD<2>, LDD<3>, LDD<4>, LDD<5>, LDD<6>, LDD<7>,
               LDD<8>, LDD<9>, LDD<10>, LDD<11>, LDD<12>, LDD<13>,
               LDD<14>, LDD<15>, LDD<16>, LDD<17>, MBGNT, MBREQ, MMCLK,
               MMCMD, MMDAT<0>, MMDAT<1>, MMDAT<2>, MMDAT<3>, MSBS,
               MSSCLK, MSSDIO, nCS<2>, nCS<3>, nCS<4>, nCS<5>, nIOS16,
               nMSINS, nPCE<1>, nPCE<2>, nPIOR, nPIOW, nPOE, nPREG,
               nPWAIT, nPWE, nSDCS<2>, nSDCS<3>, nURST, nUVS1, nUVS2,
               PSKTSEL, PWM_OUT<0>, PWM_OUT<1>, PWM_OUT<2>, PWM_OUT<3>,
               RDY, SCL, SDA, SSPCLK3, SSPEXTCLK, SSPEXTCLK2, SSPRXD,
               SSPRXD2, SSPRXD3, SSPSCLK, SSPSCLK2, SSPSCLK3, SSPSCLKEN,
               SSPSCLKEN2, SSPSFRM, SSPSFRM2, SSPSFRM3, SSPSYSCLK,
               SSPSYSCLK2, SSPSYSCLK3, SSPTXD, SSPTXD2, SSPTXD3, STD_RXD,
               STD_TXD, UCLK, UDET, UEN, USB_P2_1, USB_P2_2, USB_P2_3,
               USB_P2_4, USB_P2_5, USB_P2_6, USB_P2_7, USB_P2_8, USB_P3_1,
               USB_P3_2, USB_P3_3, USB_P3_4, USB_P3_5, USB_P3_6,
               USBHPEN<1>, USBHPEN<2>, USBHPWR<1>, USBHPWR<2>, UVS0]

required:
  - compatible
  - reg

allOf:
  - $ref: pinctrl.yaml#

  - if:
      properties:
        compatible:
          contains:
            const: marvell,pxa25x-pinctrl
    then:
      patternProperties:
        "-pins$":
          $ref: "#/$defs/pxa25x-pins"
          patternProperties:
            "-pins$":
              $ref: "#/$defs/pxa25x-pins"

  - if:
      properties:
        compatible:
          contains:
            const: marvell,pxa27x-pinctrl
    then:
      patternProperties:
        "-pins$":
          $ref: "#/$defs/pxa27x-pins"
          patternProperties:
            "-pins$":
              $ref: "#/$defs/pxa27x-pins"

unevaluatedProperties: false

examples:
  - |
    pinctrl@40e00054 {
        compatible = "marvell,pxa25x-pinctrl";
        reg = <0x40e00054 0x20>, <0x40e0000c 0xc>, <0x40e0010c 0x4>,
              <0x40f00020 0x10>;

        backlight-pwm-pins {
            groups = "P16";
            function = "PWM0";
            low-power-disable;
        };

        backlight-enable-pins {
            groups = "P17";
            function = "gpio_out";
            low-power-disable;
        };

        lcd-pins {
            lcd0-pins {
                groups = "P58";
                function = "LDD<0>";
            };

            lcd1-pins {
                groups = "P59";
                function = "LDD<1>";
                low-power-disable;
            };

            lcd-power-pins {
                groups = "P60", "P61";
                function = "gpio_out";
                low-power-enable;
            };
        };
    };

  - |
    pinctrl@40e00054 {
        compatible = "marvell,pxa27x-pinctrl";
        reg = <0x40e00054 0x20>, <0x40e0000c 0xc>, <0x40e0010c 0x4>,
              <0x40f00020 0x10>;

        backlight-pwm-pins {
            groups = "P17";
            function = "PWM_OUT<1>";
            low-power-disable;
        };
    };

...
```

## Documentation/devicetree/bindings/power/supply/usb-vbus-charger.yaml
```yaml
# SPDX-License-Identifier: (GPL-2.0-only OR BSD-2-Clause)
%YAML 1.2
---
$id: http://devicetree.org/schemas/power/supply/usb-vbus-charger.yaml#
$schema: http://devicetree.org/meta-schemas/core.yaml#

title: USB VBUS charge input sensed through a USB PHY

maintainers:
  - Koen Kooi <koen@dominion.thruhere.net>

description:
  A USB device port whose VBUS feeds a battery charger, with VBUS presence
  reported by the USB PHY rather than by a GPIO of its own. The supply is
  online while the PHY reports VBUS. An optional GPIO switches VBUS into
  the charger input; it is closed while VBUS is present and the optional
  priority charger, typically a mains adapter input of the same charger,
  is offline. Optional GPIOs select the charge current drawn from VBUS.
  While VBUS feeds the charger this is the highest current in the mapping
  that does not exceed what the configuration accepted by the USB host
  allows, and otherwise the default current.

allOf:
  - $ref: power-supply.yaml#

properties:
  compatible:
    const: usb-vbus-charger

  enable-gpios:
    maxItems: 1
    description:
      Switch that connects VBUS to the charger input, asserted to connect.

  usb-phy:
    $ref: /schemas/types.yaml#/definitions/phandle
    description:
      USB PHY that senses VBUS. Without it the system's USB2 PHY is used.

  priority-charger:
    $ref: /schemas/types.yaml#/definitions/phandle
    description:
      Power supply whose input takes precedence over VBUS. While it is
      online the enable switch is kept open.

  charge-current-limit-gpios:
    minItems: 1
    maxItems: 32
    description:
      GPIOs that select the charge current taken from VBUS.

  charge-current-limit-mapping:
    description:
      List of tuples with a current in uA and a GPIO bitmap, in that
      order, sorted by descending current.
    $ref: /schemas/types.yaml#/definitions/uint32-matrix
    items:
      items:
        - description:
            Current limit in uA
        - description:
            Encoded GPIO setting. Bit 0 represents the last GPIO of
            charge-current-limit-gpios, bit 1 the second to last, and so
            on.

  charge-current-limit-default-microamp:
    description:
      Current selected at probe and whenever no configuration accepted by
      the USB host allows more, including while VBUS is absent or the
      priority charger is online. Must be listed in
      charge-current-limit-mapping. Without it the lowest current in the
      mapping is used.

dependencies:
  charge-current-limit-gpios: [ charge-current-limit-mapping ]
  charge-current-limit-mapping: [ charge-current-limit-gpios ]
  charge-current-limit-default-microamp: [ charge-current-limit-mapping ]

required:
  - compatible

unevaluatedProperties: false

examples:
  - |
    #include <dt-bindings/gpio/gpio.h>

    charger-usb {
        compatible = "usb-vbus-charger";
        enable-gpios = <&gpio 59 GPIO_ACTIVE_HIGH>;
        usb-phy = <&usb_vbus>;
        priority-charger = <&charger_ac>;
    };

  - |
    #include <dt-bindings/gpio/gpio.h>

    charger-usb {
        compatible = "usb-vbus-charger";
        usb-phy = <&usb_vbus>;
        charge-current-limit-gpios = <&gpio 96 GPIO_ACTIVE_HIGH>;
        charge-current-limit-mapping = <500000 0x1>, <100000 0x0>;
        charge-current-limit-default-microamp = <100000>;
    };
```

## Documentation/devicetree/bindings/pwm/htc,asic2-pwm.yaml
```yaml
# SPDX-License-Identifier: (GPL-2.0-only OR BSD-2-Clause)
%YAML 1.2
---
$id: http://devicetree.org/schemas/pwm/htc,asic2-pwm.yaml#
$schema: http://devicetree.org/meta-schemas/core.yaml#

title: HTC/Compaq ASIC2 companion ASIC PWM block

maintainers:
  - Koen Kooi <koen@dominion.thruhere.net>

description: >-
  The 2-channel PWM block (TimeBase/PeriodTime/DutyTime per channel) of the
  ASIC2 companion ASIC found on the HP/Compaq iPAQ h38xx/h39xx family
  (see htc,asic2.yaml), driving PWM0 to the LCD frontlight on every known
  board. Its register window comes from the mfd cell of the parent
  htc,asic2 node, so this node has no reg of its own. Its clocks are
  two gates of the parent: this block's own and the EX1 crystal gate that
  every block clocked this way also needs.

  The divider select of TimeBase and PeriodTime are board parameters. The
  vendor software of h38xx programs divider 8 with a period of 64, where
  h39xx uses divider 7 with a period of 10, so a board whose hardware
  differs supplies its own pair with the two properties below.

allOf:
  - $ref: pwm.yaml#

properties:
  compatible:
    const: htc,asic2-pwm

  "#pwm-cells":
    const: 2

  clocks:
    items:
      - description: The parent's PWM clock gate
      - description: The parent's EX1 crystal gate

  clock-names:
    items:
      - const: ref
      - const: ex1

  htc,pwm-divider:
    $ref: /schemas/types.yaml#/definitions/uint32
    minimum: 0
    maximum: 8
    description:
      The 4-bit clock divider select of TimeBase, 0 to 8. This is the raw
      register field, not a frequency, as the output frequency of each
      value is not documented.

  htc,pwm-period:
    $ref: /schemas/types.yaml#/definitions/uint32
    minimum: 1
    maximum: 255
    description:
      The 8-bit PeriodTime register value. The duty cycle floor enforced by
      the driver, about 33 percent, scales with the configured period.

required:
  - compatible
  - "#pwm-cells"
  - clocks
  - clock-names

additionalProperties: false

examples:
  - |
    #include <dt-bindings/clock/htc,asic2.h>

    pwm {
        compatible = "htc,asic2-pwm";
        #pwm-cells = <2>;
        clocks = <&asic2 ASIC2_CLK_PWM>, <&asic2 ASIC2_CLK_EX1>;
        clock-names = "ref", "ex1";
        htc,pwm-divider = <8>;
        htc,pwm-period = <64>;
    };

...
```
