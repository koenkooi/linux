## Documentation/devicetree/bindings/regulator/maxim,max1586.yaml
```yaml
# SPDX-License-Identifier: (GPL-2.0-only OR BSD-2-Clause)
%YAML 1.2
---
$id: http://devicetree.org/schemas/regulator/maxim,max1586.yaml#
$schema: http://devicetree.org/meta-schemas/core.yaml#

title: Maxim MAX1586 Power Management IC

maintainers:
  - Koen Kooi <koen@dominion.thruhere.net>

description:
  The MAX1586 is a power management IC with I2C programmable voltage outputs.
  Output V3 is selectable in 25 mV steps from 0.7 V to 1.475 V, before the
  gain of its external feedback resistors is applied. Output V6 is selectable
  between off, 1.8 V, 2.5 V and 3.0 V. The selected voltages cannot be read
  back.

properties:
  compatible:
    const: maxim,max1586

  reg:
    maxItems: 1

  v3-gain:
    $ref: /schemas/types.yaml#/definitions/uint32
    minimum: 1000000
    description:
      Gain of the V3 output in millionths, set by the external feedback
      resistors R24 and R25 as 1 + R24 / R25 + R24 / 185.5 kOhm. A value of
      1000000 is a gain of 1.

  regulators:
    type: object
    description:
      Container of the regulator output nodes. An output node is identified
      either by its node name, Output_V3 or Output_V6, or by the
      regulator-compatible property.

    patternProperties:
      "^Output_V[36]$":
        type: object
        $ref: /schemas/regulator/regulator.yaml#
        unevaluatedProperties: false

      "^[a-z][a-z0-9_-]*$":
        type: object
        $ref: /schemas/regulator/regulator.yaml#
        unevaluatedProperties: false

        properties:
          regulator-compatible:
            $ref: /schemas/types.yaml#/definitions/string
            enum: [Output_V3, Output_V6]
            deprecated: true
            description:
              Output described by the node, Output_V3 for the V3 output and
              Output_V6 for the V6 output.

        required:
          - regulator-compatible

    additionalProperties: false

required:
  - compatible
  - reg
  - v3-gain
  - regulators

additionalProperties: false

examples:
  - |
    i2c {
        #address-cells = <1>;
        #size-cells = <0>;

        regulator@14 {
            compatible = "maxim,max1586";
            reg = <0x14>;
            v3-gain = <1051098>;

            regulators {
                vcc_core: v3 {
                    regulator-name = "vcc_core";
                    regulator-compatible = "Output_V3";
                    regulator-min-microvolt = <900000>;
                    regulator-max-microvolt = <1705000>;
                    regulator-always-on;
                };
            };
        };
    };
```

## Documentation/devicetree/bindings/rtc/marvell,pxa-rtc.yaml
```yaml
# SPDX-License-Identifier: (GPL-2.0-only OR BSD-2-Clause)
%YAML 1.2
---
$id: http://devicetree.org/schemas/rtc/marvell,pxa-rtc.yaml#
$schema: http://devicetree.org/meta-schemas/core.yaml#

title: PXA Real Time Clock

maintainers:
  - Javier Carrasco <javier.carrasco.cruz@gmail.com>

allOf:
  - $ref: rtc.yaml#

properties:
  compatible:
    const: marvell,pxa-rtc

  reg:
    maxItems: 1

  interrupts:
    items:
      - description: 1 Hz
      - description: Alarm

  clocks:
    maxItems: 1
    description: 32.768 kHz oscillator that clocks the counter.

required:
  - compatible
  - reg
  - interrupts
  - clocks

unevaluatedProperties: false

examples:
  - |
    #include <dt-bindings/clock/pxa-clock.h>

    rtc@40900000 {
        compatible = "marvell,pxa-rtc";
        reg = <0x40900000 0x3c>;
        interrupts = <30>, <31>;
        clocks = <&clks CLK_OSC32k768>;
    };
```

## Documentation/devicetree/bindings/serial/htc,asic2-uart.yaml
```yaml
# SPDX-License-Identifier: (GPL-2.0-only OR BSD-2-Clause)
%YAML 1.2
---
$id: http://devicetree.org/schemas/serial/htc,asic2-uart.yaml#
$schema: http://devicetree.org/meta-schemas/core.yaml#

title: HTC ASIC2 companion ASIC UART block

maintainers:
  - Koen Kooi <koen@dominion.thruhere.net>

description: >-
  ASIC2 is a companion ASIC found on the HP/Compaq iPAQ h38xx/h39xx family
  (see htc,asic2.yaml). Its UART0 and UART1 blocks are a pair of
  16550A-compatible register windows with a 4-byte stride. UART0 is the
  Bluetooth transport of the h3870/h3875, a CSR BlueCore radio attached
  from userspace with hciattach, so no child node is described for it.

  This node is always a child of an htc,asic2 node and has no reg of its
  own. The parent driver hands the cell its register sub-window and its
  demultiplexed interrupt.

  The block is bound by a thin glue driver for the stock 8250 core, not by
  the generic 8250 platform binding: the parent driver maps its window
  non-exclusively so that this cell can take the only exclusive claim on
  its own disjoint sub-range, which a stock 8250 platform device sharing
  ASIC2's window could not do.

allOf:
  - $ref: /schemas/serial/serial.yaml#

properties:
  compatible:
    const: htc,asic2-uart

  clock-frequency:
    description:
      The reference clock of the block. It is not the 24.576 MHz crystal of
      ASIC2 but a 3.6864 MHz tap that the SA-1110 supplies on GPIO27, gated
      on the ASIC2 side by the UART0 reference clock gate of the parent
      driver. Defaults to 3686400 when absent, the only value any known
      board needs.

  clocks:
    items:
      - description: The parent's UART0 reference clock select gate
      - description: The parent's EX1 crystal gate

  clock-names:
    items:
      - const: sel
      - const: ex1

required:
  - compatible
  - clocks
  - clock-names

unevaluatedProperties: false

examples:
  - |
    #include <dt-bindings/clock/htc,asic2.h>
    #include <dt-bindings/interrupt-controller/irq.h>

    asic2: companion-chip@49000000 {
        compatible = "htc,asic2";
        reg = <0x49000000 0x2000>;
        interrupt-parent = <&gpio>;
        interrupts = <1 IRQ_TYPE_EDGE_RISING>;
        gpio-controller;
        #gpio-cells = <2>;
        #clock-cells = <1>;

        serial {
            compatible = "htc,asic2-uart";
            clock-frequency = <3686400>;
            clocks = <&asic2 ASIC2_CLK_SLOW_UART_0>, <&asic2 ASIC2_CLK_EX1>;
            clock-names = "sel", "ex1";
        };
    };

...
```
