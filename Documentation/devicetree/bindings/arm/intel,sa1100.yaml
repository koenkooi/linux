## Documentation/devicetree/bindings/input/htc,asic2-keys.yaml
```yaml
# SPDX-License-Identifier: (GPL-2.0-only OR BSD-2-Clause)
%YAML 1.2
---
$id: http://devicetree.org/schemas/input/htc,asic2-keys.yaml#
$schema: http://devicetree.org/meta-schemas/core.yaml#

title: Keypad driver for the Compaq/HTC ASIC2 companion ASIC

maintainers:
  - Koen Kooi <koen@dominion.thruhere.net>

description: >-
  This module is part of the ASIC2 MFD device, see htc,asic2.yaml. The
  keypad is represented as a sub-node of the ASIC2 node.

  The KPIO block of ASIC2 exposes 12 active-low keypad lines as bits of one
  Data register, not as a scanned row and column matrix. Seven lines map
  one to one to a physical button. The other five belong to a five-way
  navigation pad whose Up, Down and centre positions are each an exact
  match of a combination of three bits, not one bit apiece. The
  "linux,keymap" property of matrix-keymap.yaml cannot express a key that
  fires only when several bits match a pattern together. This binding
  therefore follows the shape of adc-keys.yaml: one "button-*" child per
  key, each carrying the bitmask and pattern that the driver tests against
  the Data register as "pressed = ((~Data & htc,key-mask) == htc,key-match)".

  The h3800 and h39xx share the same physical KPIO wiring, but a board is
  free to describe its own mapping and the driver never assumes the two
  agree.

properties:
  compatible:
    const: htc,asic2-keys

patternProperties:
  "^button-":
    type: object
    $ref: input.yaml#
    additionalProperties: false
    description:
      Each key (including each of the five-way pad's five positions) is
      represented as a sub-node.

    properties:
      label: true

      linux,code: true

      htc,key-mask:
        $ref: /schemas/types.yaml#/definitions/uint32
        maximum: 0xfff
        description:
          Which bits of the KPIO Data register the match condition of this
          key covers. For the seven direct buttons this is the single bit
          of the key. For the Up, Down and centre positions of the five-way
          pad it is 0x3e, the same three-bit group for all three, which the
          driver also writes to the Alternate register.

      htc,key-match:
        $ref: /schemas/types.yaml#/definitions/uint32
        maximum: 0xfff
        description:
          The exact value that "~Data & htc,key-mask" must equal for this
          key to count as pressed. It must be a subset of htc,key-mask. For
          a one-bit key it is identical to htc,key-mask.

    required:
      - linux,code
      - htc,key-mask
      - htc,key-match

required:
  - compatible

additionalProperties: false

examples:
  - |
    companion-chip {
        keys {
            compatible = "htc,asic2-keys";

            button-record {
                label = "Record";
                linux,code = <128>; /* KEY_RECORD */
                htc,key-mask = <0x001>;
                htc,key-match = <0x001>;
            };

            button-nav-up {
                label = "5-way up";
                linux,code = <103>; /* KEY_UP */
                htc,key-mask = <0x03e>;
                htc,key-match = <0x032>;
            };

            button-nav-down {
                label = "5-way down";
                linux,code = <108>; /* KEY_DOWN */
                htc,key-mask = <0x03e>;
                htc,key-match = <0x02c>;
            };

            button-nav-center {
                label = "5-way centre";
                linux,code = <28>; /* KEY_ENTER */
                htc,key-mask = <0x03e>;
                htc,key-match = <0x020>;
            };
        };
    };
```

## Documentation/devicetree/bindings/input/synaptics,navpoint.yaml
```yaml
# SPDX-License-Identifier: GPL-2.0-only OR BSD-2-Clause
%YAML 1.2
---
$id: http://devicetree.org/schemas/input/synaptics,navpoint.yaml#
$schema: http://devicetree.org/meta-schemas/core.yaml#

title: Synaptics NavPoint touchpad

maintainers:
  - Koen Kooi <koen@dominion.thruhere.net>

description:
  Touchpad module that drives the clock and frame signals of its SPI link
  and sends position packets to the host. It is therefore connected to a SPI
  controller operating as a target, and its node must be named "slave".

allOf:
  - $ref: /schemas/spi/spi-peripheral-props.yaml#

properties:
  compatible:
    const: synaptics,navpoint

  vdd-supply:
    description: Power supply of the module

required:
  - compatible
  - vdd-supply

unevaluatedProperties: false

examples:
  - |
    spi {
        spi-slave;
        #address-cells = <0>;
        #size-cells = <0>;

        slave {
            compatible = "synaptics,navpoint";
            vdd-supply = <&navpoint_vdd>;
        };
    };
```

## Documentation/devicetree/bindings/interrupt-controller/intel,sa1100-intc.yaml
```yaml
# SPDX-License-Identifier: GPL-2.0-only OR BSD-2-Clause
%YAML 1.2
---
$id: http://devicetree.org/schemas/interrupt-controller/intel,sa1100-intc.yaml#
$schema: http://devicetree.org/meta-schemas/core.yaml#

title: Intel SA-1100/SA-1110 interrupt controller

maintainers:
  - Koen Kooi <koen@dominion.thruhere.net>

description: >-
  The SA-1100/SA-1110 on-chip interrupt controller (ICIP, ICMR, ICLR,
  ICCR and ICPR registers). All on-chip peripheral interrupts, and the
  aggregate lines of the GPIO0-27 demultiplexer, are routed through it.
  The controller has no per-line trigger type configuration, so
  #interrupt-cells is a bare hardware interrupt number.

properties:
  compatible:
    items:
      - const: intel,sa1110-intc
      - const: intel,sa1100-intc

  reg:
    maxItems: 1

  interrupt-controller: true

  '#interrupt-cells':
    const: 1

required:
  - compatible
  - reg
  - interrupt-controller
  - '#interrupt-cells'

additionalProperties: false

examples:
  - |
    interrupt-controller@90050000 {
        compatible = "intel,sa1110-intc", "intel,sa1100-intc";
        reg = <0x90050000 0x24>;
        interrupt-controller;
        #interrupt-cells = <1>;
    };

...
```

## Documentation/devicetree/bindings/interrupt-controller/marvell,pxa-intc.yaml
```yaml
# SPDX-License-Identifier: (GPL-2.0-only OR BSD-2-Clause)
%YAML 1.2
---
$id: http://devicetree.org/schemas/interrupt-controller/marvell,pxa-intc.yaml#
$schema: http://devicetree.org/meta-schemas/core.yaml#

title: Marvell PXA on-chip interrupt controller

maintainers:
  - Koen Kooi <koen@dominion.thruhere.net>

description:
  The interrupt controller integrated in the PXA25x, PXA27x and PXA3xx
  application processors (formerly Intel XScale-based). It collects the
  interrupt sources of the on-chip peripherals, including the shared lines of
  the GPIO block, and presents them to the IRQ input of the CPU core. It is
  the root of the interrupt tree and has no parent interrupt controller.
  Interrupt sources are numbered from 0 and the controller registers are
  organised in banks of 32 sources.

allOf:
  - $ref: /schemas/interrupt-controller.yaml#

properties:
  compatible:
    const: marvell,pxa-intc

  reg:
    maxItems: 1

  interrupt-controller: true

  '#interrupt-cells':
    const: 1
    description:
      The single cell is the number of the interrupt source.

  marvell,intc-nr-irqs:
    description:
      Number of interrupt sources implemented by the controller. This is 32 on
      the PXA25x, 34 on the PXA27x and 56 on the PXA3xx.
    $ref: /schemas/types.yaml#/definitions/uint32
    minimum: 1
    maximum: 96

  marvell,intc-priority:
    description:
      Present when the per-source interrupt priority registers are to be
      programmed. Each source is then assigned a distinct priority, and the
      registers are saved and restored across suspend.
    type: boolean

required:
  - compatible
  - reg
  - interrupt-controller
  - '#interrupt-cells'
  - marvell,intc-nr-irqs

unevaluatedProperties: false

examples:
  - |
    interrupt-controller@40d00000 {
        compatible = "marvell,pxa-intc";
        reg = <0x40d00000 0xd0>;
        interrupt-controller;
        #interrupt-cells = <1>;
        marvell,intc-nr-irqs = <34>;
        marvell,intc-priority;
    };

  - |
    interrupt-controller@40d00000 {
        compatible = "marvell,pxa-intc";
        reg = <0x40d00000 0xd0>;
        interrupt-controller;
        #interrupt-cells = <1>;
        marvell,intc-nr-irqs = <32>;
        marvell,intc-priority;
    };
```

## Documentation/devicetree/bindings/leds/htc,asic2-leds.yaml
```yaml
# SPDX-License-Identifier: (GPL-2.0-only OR BSD-2-Clause)
%YAML 1.2
---
$id: http://devicetree.org/schemas/leds/htc,asic2-leds.yaml#
$schema: http://devicetree.org/meta-schemas/core.yaml#

title: LED driver for the Compaq/HTC ASIC2 companion ASIC

maintainers:
  - Koen Kooi <koen@dominion.thruhere.net>

description:
  This module is part of the ASIC2 MFD device, see htc,asic2.yaml. The LED
  controller is represented as a sub-node of the ASIC2 node, in the same way
  as that of htc,asic3-leds.yaml.

  ASIC2 has three independent LED channels with hardware blink, each with
  its own duty cycle and period timer, switched through a timebase register
  rather than a plain GPIO output. It is the same LED block as that of ASIC3
  at different register offsets.

properties:
  compatible:
    const: htc,asic2-leds

  "#address-cells":
    const: 1

  "#size-cells":
    const: 0

patternProperties:
  "^led@[0-2]$":
    type: object
    $ref: common.yaml#
    unevaluatedProperties: false

    properties:
      reg:
        description:
          Index of the LED channel.
        minimum: 0
        maximum: 2

required:
  - compatible
  - "#address-cells"
  - "#size-cells"

additionalProperties: false

examples:
  - |
    #include <dt-bindings/leds/common.h>

    companion-chip {
        led-controller {
            compatible = "htc,asic2-leds";
            #address-cells = <1>;
            #size-cells = <0>;

            led@0 {
                reg = <0>;
                function = LED_FUNCTION_BLUETOOTH;
                color = <LED_COLOR_ID_BLUE>;
            };

            led@1 {
                reg = <1>;
                function = LED_FUNCTION_STATUS;
                color = <LED_COLOR_ID_GREEN>;
                linux,default-trigger = "heartbeat";
            };

            led@2 {
                reg = <2>;
                function = LED_FUNCTION_CHARGING;
                color = <LED_COLOR_ID_AMBER>;
            };
        };
    };
```

## Documentation/devicetree/bindings/leds/htc,asic3-leds.yaml
```yaml
# SPDX-License-Identifier: (GPL-2.0-only OR BSD-2-Clause)
%YAML 1.2
---
$id: http://devicetree.org/schemas/leds/htc,asic3-leds.yaml#
$schema: http://devicetree.org/meta-schemas/core.yaml#

title: LED driver for the Compaq/HTC ASIC3 companion ASIC

maintainers:
  - Koen Kooi <koen@dominion.thruhere.net>

description:
  This module is part of the ASIC3 MFD device, see
  Documentation/devicetree/bindings/mfd/htc,asic3.yaml. The LED
  controller is represented as a sub-node of the ASIC3 node.

  ASIC3 has three independent, hardware-blink-capable LED channels, each
  with its own duty-cycle and period timer, switched via a timebase
  register rather than a plain GPIO output.

properties:
  compatible:
    const: htc,asic3-leds

  "#address-cells":
    const: 1

  "#size-cells":
    const: 0

patternProperties:
  "^led@[0-2]$":
    type: object
    $ref: common.yaml#
    unevaluatedProperties: false

    properties:
      reg:
        description:
          Index of the LED channel (ASIC3_LED0/1/2_Base).
        minimum: 0
        maximum: 2

required:
  - compatible
  - "#address-cells"
  - "#size-cells"

additionalProperties: false

examples:
  - |
    #include <dt-bindings/leds/common.h>

    companion-chip {
        led-controller {
            compatible = "htc,asic3-leds";
            #address-cells = <1>;
            #size-cells = <0>;

            led@0 {
                reg = <0>;
                function = LED_FUNCTION_POWER;
                color = <LED_COLOR_ID_AMBER>;
            };

            led@1 {
                reg = <1>;
                function = LED_FUNCTION_STATUS;
                color = <LED_COLOR_ID_GREEN>;
            };

            led@2 {
                reg = <2>;
                function = LED_FUNCTION_BLUETOOTH;
                color = <LED_COLOR_ID_BLUE>;
            };
        };
    };
```

## Documentation/devicetree/bindings/media/marvell,pxa270-qci.yaml
```yaml
# SPDX-License-Identifier: (GPL-2.0-only OR BSD-2-Clause)
%YAML 1.2
---
$id: http://devicetree.org/schemas/media/marvell,pxa270-qci.yaml#
$schema: http://devicetree.org/meta-schemas/core.yaml#

title: Marvell PXA27x Quick Capture Interface

maintainers:
  - Koen Kooi <koen@dominion.thruhere.net>

description:
  The Quick Capture Interface of the PXA27x SoC receives video data from a
  camera sensor over a parallel bus and stores the Y, U and V planes through
  three DMA channels. It can supply the sensor master clock (MCLK), derived
  from its input clock.

properties:
  compatible:
    const: marvell,pxa270-qci

  reg:
    maxItems: 1

  interrupts:
    maxItems: 1

  clocks:
    maxItems: 1
    description:
      Input clock of the interface, from which MCLK is derived.

  clock-names:
    const: ciclk

  clock-frequency:
    description:
      Frequency of MCLK in Hz. The interface drives MCLK at the highest
      frequency not above this value that it can derive from its input clock
      by an even integer division, and never above a quarter of the input
      clock frequency. When absent, the interface does not drive MCLK.

  dmas:
    items:
      - description: Y plane channel
      - description: U plane channel
      - description: V plane channel

  dma-names:
    items:
      - const: CI_Y
      - const: CI_U
      - const: CI_V

  port:
    $ref: /schemas/graph.yaml#/$defs/port-base
    unevaluatedProperties: false
    description:
      Parallel video bus connected to the sensor.

    properties:
      endpoint:
        $ref: /schemas/media/video-interfaces.yaml#
        additionalProperties: false

        properties:
          bus-type:
            const: 5

          bus-width:
            enum: [4, 5, 8, 9, 10]

          hsync-active: true
          vsync-active: true

          pclk-sample:
            enum: [0, 1]

          slave-mode: true
          remote-endpoint: true

        required:
          - bus-width
          - remote-endpoint

required:
  - compatible
  - reg
  - interrupts
  - clocks
  - dmas
  - dma-names
  - port

additionalProperties: false

examples:
  - |
    #include <dt-bindings/clock/pxa-clock.h>

    imaging@50000000 {
        compatible = "marvell,pxa270-qci";
        reg = <0x50000000 0x1000>;
        interrupts = <33>;
        dmas = <&pdma 68 0>,   /* Y channel */
               <&pdma 69 0>,   /* U channel */
               <&pdma 70 0>;   /* V channel */
        dma-names = "CI_Y", "CI_U", "CI_V";
        clocks = <&clks CLK_CAMERA>;
        clock-names = "ciclk";
        clock-frequency = <5000000>;

        port {
            qci_ep: endpoint {
                remote-endpoint = <&mt9m111_ep>;
                bus-width = <8>;
                hsync-active = <0>;
                vsync-active = <0>;
                pclk-sample = <1>;
            };
        };
    };
```
