## Documentation/devicetree/bindings/sound/marvell,pxa2xx-i2s.yaml
```yaml
# SPDX-License-Identifier: (GPL-2.0-only OR BSD-2-Clause)
%YAML 1.2
---
$id: http://devicetree.org/schemas/sound/marvell,pxa2xx-i2s.yaml#
$schema: http://devicetree.org/meta-schemas/core.yaml#

title: Marvell/Intel PXA2xx I2S controller

maintainers:
  - Koen Kooi <koen@dominion.thruhere.net>

description: |
  The I2S serial audio controller integrated into the PXA25x and PXA27x
  SoC family. The block is identical across both SoCs in register layout,
  interrupt, clock id and DMA request line numbering, so one family-wide
  compatible string covers it.

  The DMA channels are resolved through the dmas and dma-names properties
  of this node; without them the PCM open of a DT boot fails with
  -ENXIO.

properties:
  compatible:
    const: marvell,pxa2xx-i2s

  reg:
    maxItems: 1

  interrupts:
    maxItems: 1
    description: |
      IRQ_I2S. Informational only, the driver does not request it.

  clocks:
    maxItems: 1

  clock-names:
    const: I2SCLK
    description: |
      Required: the driver looks the clock up by the connection id
      "I2SCLK", which on a DT-probed device is matched against this
      property.

  dmas:
    minItems: 2
    maxItems: 2

  dma-names:
    items:
      - const: rx
      - const: tx

  "#sound-dai-cells":
    const: 0

required:
  - compatible
  - reg
  - clocks
  - clock-names
  - "#sound-dai-cells"

unevaluatedProperties: false

examples:
  - |
    #include <dt-bindings/clock/pxa-clock.h>

    i2s: i2s@40400000 {
        compatible = "marvell,pxa2xx-i2s";
        reg = <0x40400000 0x100>;
        interrupts = <13>;
        clocks = <&clks CLK_I2S>;
        clock-names = "I2SCLK";
        dmas = <&pdma 2 3
                &pdma 3 3>;
        dma-names = "rx", "tx";
        #sound-dai-cells = <0>;
    };
```

## Documentation/devicetree/bindings/sound/nxp,uda1341.yaml
```yaml
# SPDX-License-Identifier: (GPL-2.0-only OR BSD-2-Clause)
%YAML 1.2
---
$id: http://devicetree.org/schemas/sound/nxp,uda1341.yaml#
$schema: http://devicetree.org/meta-schemas/core.yaml#

title: NXP/Philips UDA1341TS audio CODEC

maintainers:
  - Koen Kooi <koen@dominion.thruhere.net>

description: |
  UDA1341TS is a stereo audio CODEC controlled over L3, a 3-wire
  bit-banged control bus (DATA/MODE/CLOCK) entirely distinct from its
  digital audio interface (I2S or MSB/LSB-justified), found on the
  HP/Compaq iPAQ h38xx family. L3 has no register readback of any kind,
  so this binding carries no "reg". The three L3 lines are wired to plain
  GPIO lines; there is no L3 bus controller.

properties:
  compatible:
    const: nxp,uda1341ts

  l3-data-gpios:
    maxItems: 1
    description: L3 DATA line.

  l3-mode-gpios:
    maxItems: 1
    description: L3 MODE line.

  l3-clock-gpios:
    maxItems: 1
    description: L3 CLOCK line.

  "#sound-dai-cells":
    const: 0

required:
  - compatible
  - l3-data-gpios
  - l3-mode-gpios
  - l3-clock-gpios
  - "#sound-dai-cells"

unevaluatedProperties: false

allOf:
  - $ref: dai-common.yaml#

examples:
  - |
    #include <dt-bindings/gpio/gpio.h>

    codec {
        compatible = "nxp,uda1341ts";

        l3-data-gpios = <&gpio 14 GPIO_ACTIVE_HIGH>;
        l3-mode-gpios = <&gpio 15 GPIO_ACTIVE_HIGH>;
        l3-clock-gpios = <&gpio 16 GPIO_ACTIVE_HIGH>;

        #sound-dai-cells = <0>;
    };

...
```

## Documentation/devicetree/bindings/sound/nxp,uda1380.yaml
```yaml
# SPDX-License-Identifier: (GPL-2.0-only OR BSD-2-Clause)
%YAML 1.2
---
$id: http://devicetree.org/schemas/sound/nxp,uda1380.yaml#
$schema: http://devicetree.org/meta-schemas/core.yaml#

title: NXP/Philips UDA1380 audio CODEC

maintainers:
  - Koen Kooi <koen@dominion.thruhere.net>

description: |
  UDA1380 is an I2C-controlled stereo audio CODEC with a separate I2S (or
  MSB/LSB-justified) digital audio interface, found on the HP iPAQ h2200
  and h39xx, the HTC Magician, and a number of other mid-2000s PDA/phone
  designs. sound/soc/codecs/uda1380.c is I2C-only and gpiod-based: its
  reset and power pins are each obtained via devm_gpiod_get_optional(),
  so a board with neither GPIO wired to the codec (register-only
  reset/power sequencing) can omit both properties.

  The lpc3250-phy3250 and lpc3250-ea3250 devicetrees still use the legacy
  singular "power-gpio" and "reset-gpio" property names, which the gpiod
  core does not match to the "power" and "reset" connection ids of the
  driver. This binding describes the "-gpios" form the driver consumes.

properties:
  compatible:
    const: nxp,uda1380

  reg:
    maxItems: 1

  reset-gpios:
    maxItems: 1
    description: |
      Active-high hardware reset pin. When present, driven high then low
      by the driver's own reset sequence (mdelay(1) between edges); when
      absent, reset falls back to an I2C SW-reset register write instead.

  power-gpios:
    maxItems: 1
    description: |
      Active-high chip power-enable pin, if the board gates the codec's
      supply through a discrete GPIO rather than a regulator or a
      permanently-on rail. When present, driven high before the reset
      pulse on power-up and low on power-down (SND_SOC_BIAS_OFF); when
      absent, the driver assumes the chip is always powered and drives
      the SW-reset sequence directly from component probe.

  dac-clk:
    description: |
      Selects the codec's internal DAC clock source. Absent (the
      driver's own default) means the DAC free-runs from the codec's
      own system clock pin (SYSCLK); "wspll" switches it to lock the DAC
      clock to the I2S word-select PLL instead -- useful when a board's
      I2S bit/frame clocks are not derived from the same reference as
      whatever drives the codec's SYSCLK pin.
    const: wspll

  "#sound-dai-cells":
    description: |
      The driver registers three snd_soc_dai_driver entries: a combined
      full-duplex "uda1380-hifi" (index 0) plus split playback-only and
      capture-only DAIs for boards with separate serial interfaces for
      each direction. It implements no of_xlate_dai_name() hook, so a bare
      phandle reference without an index cell resolves to the combined
      interface; the split DAIs can only be selected by name.
    const: 0

required:
  - compatible
  - reg

unevaluatedProperties: false

allOf:
  - $ref: dai-common.yaml#

examples:
  - |
    #include <dt-bindings/gpio/gpio.h>

    i2c {
        #address-cells = <1>;
        #size-cells = <0>;

        codec@18 {
            compatible = "nxp,uda1380";
            reg = <0x18>;

            reset-gpios = <&gpio 71 GPIO_ACTIVE_HIGH>;
            power-gpios = <&gpio 70 GPIO_ACTIVE_HIGH>;

            #sound-dai-cells = <0>;
        };
    };
```

## Documentation/devicetree/bindings/timer/marvell,pxa-timer.yaml
```yaml
# SPDX-License-Identifier: (GPL-2.0-only OR BSD-2-Clause)
%YAML 1.2
---
$id: http://devicetree.org/schemas/timer/marvell,pxa-timer.yaml#
$schema: http://devicetree.org/meta-schemas/core.yaml#

title: Marvell PXA and Intel SA-1100 operating system timer

maintainers:
  - Koen Kooi <koen@dominion.thruhere.net>

description:
  The operating system timer block of the Intel SA-1100 and SA-1110 and of
  the Intel/Marvell PXA2xx and PXA3xx SoCs, which share one register
  layout. It has a free-running 32-bit counter and four match registers.
  The block is also the SoC watchdog. Once the watchdog enable bit (OWER.WME)
  is set, a match on register 3 resets the SoC, and the bit cannot be
  cleared again until that reset. The watchdog has no node of its own.

properties:
  compatible:
    oneOf:
      - const: marvell,pxa-timer
      - items:
          - const: intel,sa1110-timer
          - const: intel,sa1100-timer
          - const: marvell,pxa-timer

  reg:
    maxItems: 1

  interrupts:
    maxItems: 1
    description: Match interrupt of operating system timer 0.

  clocks:
    maxItems: 1
    description: Clock that counts the timer.

required:
  - compatible
  - reg
  - interrupts
  - clocks

additionalProperties: false

examples:
  - |
    timer@40a00000 {
        compatible = "marvell,pxa-timer";
        reg = <0x40a00000 0x20>;
        interrupts = <26>;
        clocks = <&clktimer>;
    };

  - |
    timer@90000000 {
        compatible = "intel,sa1110-timer", "intel,sa1100-timer",
                     "marvell,pxa-timer";
        reg = <0x90000000 0x20>;
        interrupts = <26>;
        clocks = <&clk3686400>;
    };
```

## Documentation/devicetree/bindings/usb/intel,sa1100-udc.yaml
```yaml
# SPDX-License-Identifier: (GPL-2.0-only OR BSD-2-Clause)
%YAML 1.2
---
$id: http://devicetree.org/schemas/usb/intel,sa1100-udc.yaml#
$schema: http://devicetree.org/meta-schemas/core.yaml#

title: Intel SA-1100/SA-1110 USB Device Controller (UDC)

maintainers:
  - Koen Kooi <koen@dominion.thruhere.net>

description: >-
  The integrated full-speed USB device controller of the SA-1100 and
  SA-1110 (Ser0UDCCR to Ser0UDCSR). It has fixed three-endpoint hardware:
  ep0 control (an 8-byte FIFO shared between OUT and IN) plus one bulk-OUT
  and one bulk-IN endpoint, with no interrupt endpoint of any kind. A
  gadget function that needs an interrupt or notification endpoint, such
  as ACM or CDC-ECM, therefore cannot be used.

properties:
  compatible:
    oneOf:
      - const: intel,sa1100-udc
      - items:
          - const: intel,sa1110-udc
          - const: intel,sa1100-udc

  reg:
    maxItems: 1

  interrupts:
    maxItems: 1

required:
  - compatible
  - reg
  - interrupts

additionalProperties: false

examples:
  - |
    usb@80000000 {
        compatible = "intel,sa1110-udc", "intel,sa1100-udc";
        reg = <0x80000000 0x34>;
        interrupts = <13>;
    };

...
```

## Documentation/devicetree/bindings/usb/marvell,pxa-ohci.yaml
```yaml
# SPDX-License-Identifier: (GPL-2.0-only OR BSD-2-Clause)
%YAML 1.2
---
$id: http://devicetree.org/schemas/usb/marvell,pxa-ohci.yaml#
$schema: http://devicetree.org/meta-schemas/core.yaml#

title: Marvell PXA27x/PXA3xx USB OHCI Host Controller

maintainers:
  - Koen Kooi <koen@dominion.thruhere.net>

description: >-
  The USB host controller integrated in the PXA27x and PXA3xx application
  processors: an OHCI-compliant controller for low and full speed devices
  with a root hub of three downstream ports and on-chip transceivers. Beyond
  the OHCI register set, the block has vendor registers that select the
  polarity of the port power control and power sense signals, the over-current
  protection scheme and which downstream ports are in use.

allOf:
  - $ref: usb-hcd.yaml#

properties:
  compatible:
    const: marvell,pxa-ohci

  reg:
    maxItems: 1

  interrupts:
    maxItems: 1

  clocks:
    maxItems: 1

  vbus1-supply:
    description:
      Regulator switching VBUS of downstream port 1. It is enabled when the
      root hub powers the port on and disabled when it powers the port off.

  vbus2-supply:
    description:
      Regulator switching VBUS of downstream port 2. It is enabled when the
      root hub powers the port on and disabled when it powers the port off.

  vbus3-supply:
    description:
      Regulator switching VBUS of downstream port 3. It is enabled when the
      root hub powers the port on and disabled when it powers the port off.

  marvell,enable-port1:
    type: boolean
    description: Downstream port 1 is wired to a connector and is enabled.

  marvell,enable-port2:
    type: boolean
    description: Downstream port 2 is wired to a connector and is enabled.

  marvell,enable-port3:
    type: boolean
    description: Downstream port 3 is wired to a connector and is enabled.

  marvell,port-mode:
    $ref: /schemas/types.yaml#/definitions/uint32
    enum: [1, 2, 3]
    description: |
      Port power switching mode of the root hub.
        1 - ports are not power switched and are powered continuously
        2 - all ports are power switched together
        3 - each port is power switched individually
      Without this property the ports are treated as powered continuously.

  marvell,port-sense-low:
    type: boolean
    description:
      The power sense input of the ports is active low. Without this property
      it is active high.

  marvell,power-control-low:
    type: boolean
    description:
      The port power control output is active low. Without this property it
      is active high.

  marvell,no-oc-protection:
    type: boolean
    description:
      The board has no over-current protection, so the root hub does not
      report over-current conditions.

  marvell,oc-mode-perport:
    type: boolean
    description:
      Over-current is sensed and reported for each port individually. Without
      this property it is sensed for all ports together.

  marvell,power-on-delay:
    $ref: /schemas/types.yaml#/definitions/uint32
    maximum: 510
    description:
      Time in milliseconds from switching a port on until its power is good.
      The root hub descriptor holds this time in units of 2 ms, so odd values
      are rounded down. Zero or absence keeps the hardware default.

  marvell,power-budget:
    $ref: /schemas/types.yaml#/definitions/uint32
    description:
      Total current in milliamperes that the downstream ports can supply to
      the attached devices. Zero or absence means no limit.

required:
  - compatible
  - reg
  - interrupts
  - clocks

unevaluatedProperties: false

examples:
  - |
    #include <dt-bindings/clock/pxa-clock.h>

    usb@4c000000 {
        compatible = "marvell,pxa-ohci";
        reg = <0x4c000000 0x10000>;
        interrupts = <3>;
        clocks = <&clks CLK_USBHOST>;
        marvell,enable-port1;
        marvell,port-mode = <2>;
    };

...
```

## Documentation/devicetree/bindings/usb/marvell,pxa250-udc.yaml
```yaml
# SPDX-License-Identifier: (GPL-2.0-only OR BSD-2-Clause)
%YAML 1.2
---
$id: http://devicetree.org/schemas/usb/marvell,pxa250-udc.yaml#
$schema: http://devicetree.org/meta-schemas/core.yaml#

title: Marvell PXA25x USB Device Controller (UDC)

maintainers:
  - Koen Kooi <koen@dominion.thruhere.net>

description: >-
  The full-speed USB Device Controller integrated in the PXA210/PXA250/
  PXA255/PXA26x application processors: sixteen endpoints whose types
  (ep0 control, then bulk, isochronous and interrupt endpoints in a fixed
  repeating pattern) are set by the hardware, and an integrated
  transceiver. This is a different block from the PXA27x UDC, which has
  configurable endpoints and its own binding. The D+ pullup resistor is
  not part of the controller; boards that switch it from a GPIO describe
  that line here.

properties:
  compatible:
    const: marvell,pxa250-udc

  reg:
    maxItems: 1

  interrupts:
    maxItems: 1

  clocks:
    maxItems: 1

  pullup-gpios:
    maxItems: 1
    description:
      GPIO that connects the D+ pullup resistor, making the device visible
      to the USB host when asserted.

  usb-phy:
    $ref: /schemas/types.yaml#/definitions/phandle
    description:
      Phandle of the device that senses VBUS on the USB connector and reports
      its presence or loss to the controller.

required:
  - compatible
  - reg
  - interrupts
  - clocks

additionalProperties: false

examples:
  - |
    #include <dt-bindings/clock/pxa-clock.h>
    #include <dt-bindings/gpio/gpio.h>

    usb@40600000 {
        compatible = "marvell,pxa250-udc";
        reg = <0x40600000 0x10000>;
        interrupts = <11>;
        clocks = <&clks CLK_USB>;
        pullup-gpios = <&gpio 33 GPIO_ACTIVE_LOW>;
    };

...
```
