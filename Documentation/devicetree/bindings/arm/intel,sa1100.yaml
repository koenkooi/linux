## Documentation/devicetree/bindings/arm/intel,sa1100.yaml
```yaml
# SPDX-License-Identifier: (GPL-2.0-only OR BSD-2-Clause)
%YAML 1.2
---
$id: http://devicetree.org/schemas/arm/intel,sa1100.yaml#
$schema: http://devicetree.org/meta-schemas/core.yaml#

title: Intel StrongARM SA-1100 and SA-1110 based boards

maintainers:
  - Koen Kooi <koen@dominion.thruhere.net>

properties:
  $nodename:
    const: "/"
  compatible:
    oneOf:
      - description: Boards built around the SA-1110
        items:
          - enum:
              - hp,ipaq-h3800
          - const: intel,sa1110

additionalProperties: true
```

## Documentation/devicetree/bindings/arm/marvell,pxa2xx.yaml
```yaml
# SPDX-License-Identifier: (GPL-2.0-only OR BSD-2-Clause)
%YAML 1.2
---
$id: http://devicetree.org/schemas/arm/marvell,pxa2xx.yaml#
$schema: http://devicetree.org/meta-schemas/core.yaml#

title: Marvell PXA25x and PXA27x based boards

maintainers:
  - Koen Kooi <koen@dominion.thruhere.net>

description: |
  Handheld boards built around the XScale-based PXA25x and PXA27x
  application processors. The board compatible names the board design and
  is followed by the compatible of the SoC family the board is built
  around.

  The PXA25x compatible, "marvell,pxa250", is the family compatible for
  every board with a PXA25x part, whether the fitted part is a PXA250 or
  its PXA255 revision.

  Each HP iPAQ board compatible covers the models built on one board
  design, which differ in fitted parts such as memory, flash, the SoC
  revision and the radios: hp,ipaq-h2200 covers the h2200, h2210, h2212
  and h2215; hp,ipaq-h3900 the h3950, h3955, h3970 and h3975.

properties:
  $nodename:
    const: "/"
  compatible:
    oneOf:
      - description: Boards built around the PXA250 or its PXA255 revision
        items:
          - enum:
              - hp,ipaq-h2200
              - hp,ipaq-h3900
          - const: marvell,pxa250

additionalProperties: true
```

## Documentation/devicetree/bindings/clock/intel,sa1100-clocks.yaml
```yaml
# SPDX-License-Identifier: (GPL-2.0-only OR BSD-2-Clause)
%YAML 1.2
---
$id: http://devicetree.org/schemas/clock/intel,sa1100-clocks.yaml#
$schema: http://devicetree.org/meta-schemas/core.yaml#

title: Intel SA-1100/SA-1110 clock controller

maintainers:
  - Koen Kooi <koen@dominion.thruhere.net>

description: |
  The Intel StrongARM SA-1100 and SA-1110 are clocked from two crystal
  oscillators: 3.6864 MHz on the PXTAL/PEXTAL pins, the reference of the
  core clock PLL, and 32.768 kHz on the TXTAL/TEXTAL pins, which clocks the
  power manager and the real-time clock. Both are board components and are
  described as separate fixed clocks.

  The clock controls of the chip are two registers in two different
  blocks:

  - The power manager PLL configuration register (PPCR) selects the core
    clock (CCLK) frequency as a multiple of the 3.6864 MHz reference
    through its CCF field. The LCD controller, the PC Card timing and the
    memory clock are derived from CCLK.

  - The test unit control register (TUCR) of the reset controller selects,
    through its TSEL field, which internal clock is driven on GPIO27 when
    that pin is switched to its alternate output function. TSEL values 0-7
    select the 32.768 kHz oscillator, the 3.6864 MHz oscillator, the VDD
    ring oscillator divided by 16, the 96 MHz PLL divided by 4, the
    32.768 kHz oscillator while also enabling the RCLK output on GPIO26,
    the 3.6864 MHz oscillator again, the main PLL divided by 16 and the
    VDDL ring oscillator divided by 4. Each TSEL value is a separate input
    clock of the GPIO27 output, so a board selects the value it needs with
    assigned-clock-parents; in particular TSEL 1 and 5 both provide the
    3.6864 MHz oscillator but are distinct parents. The ring oscillator
    taps have no specified frequency. TUCR also holds the memory request
    mode (MR) and power management disable (PMD) bits, which are not clock
    controls.

  The pin multiplexing of GPIO26 and GPIO27 belongs to the pin controller;
  this block only selects the clock those pins carry.

  The clock specifier is one of the indices in
  include/dt-bindings/clock/intel,sa1100-clocks.h.

properties:
  compatible:
    items:
      - const: intel,sa1110-clocks
      - const: intel,sa1100-clocks

  reg:
    items:
      - description: power manager PLL configuration register (PPCR)
      - description: test unit control register (TUCR)

  reg-names:
    items:
      - const: ppcr
      - const: tucr

  clocks:
    items:
      - description: 3.6864 MHz crystal oscillator (PXTAL)
      - description: 32.768 kHz crystal oscillator (TXTAL)

  clock-names:
    items:
      - const: pxtal
      - const: txtal

  "#clock-cells":
    const: 1

required:
  - compatible
  - reg
  - reg-names
  - clocks
  - clock-names
  - "#clock-cells"

additionalProperties: false

examples:
  - |
    #include <dt-bindings/clock/intel,sa1100-clocks.h>

    clks: clock-controller@90020014 {
        compatible = "intel,sa1110-clocks", "intel,sa1100-clocks";
        reg = <0x90020014 0x4>, <0x90030008 0x4>;
        reg-names = "ppcr", "tucr";
        clocks = <&osc3m6>, <&osc32k>;
        clock-names = "pxtal", "txtal";
        #clock-cells = <1>;
        assigned-clocks = <&clks SA1100_CLK_GPIO27>;
        assigned-clock-parents = <&clks SA1100_CLK_TSEL_OSC3M6_ALT>;
    };

...
```

## Documentation/devicetree/bindings/clock/marvell,pxa2xx-clocks.yaml
```yaml
# SPDX-License-Identifier: (GPL-2.0-only OR BSD-2-Clause)
%YAML 1.2
---
$id: http://devicetree.org/schemas/clock/marvell,pxa2xx-clocks.yaml#
$schema: http://devicetree.org/meta-schemas/core.yaml#

title: Marvell PXA25x, PXA27x and PXA3xx Clock Controllers

maintainers:
  - Koen Kooi <koen@dominion.thruhere.net>

description: |
  The clock and power manager block of the Marvell (formerly Intel) PXA25x,
  PXA27x and PXA3xx application processors. It holds the oscillator and PLL
  configuration and the clock enable register that gates the clocks of the
  on-chip peripherals. The core, system bus and memory clocks are derived from
  the PLLs by fixed and programmable dividers.

  Each clock is assigned an identifier, and client nodes use this identifier
  as the cell of their "clocks" property to select the clock they consume.
  The identifiers are found in <dt-bindings/clock/pxa-clock.h>. Which of them
  exist depends on the SoC family.

properties:
  compatible:
    enum:
      - marvell,pxa250-core-clocks # PXA250, PXA255 and PXA26x
      - marvell,pxa270-clocks # PXA27x
      - marvell,pxa300-clocks # PXA300, PXA310, PXA320 and PXA93x

  '#clock-cells':
    const: 1
    description:
      The cell is a clock identifier from <dt-bindings/clock/pxa-clock.h>.

required:
  - compatible
  - '#clock-cells'

additionalProperties: false

examples:
  - |
    clock-controller {
        compatible = "marvell,pxa270-clocks";
        #clock-cells = <1>;
    };
```

## Documentation/devicetree/bindings/display/amd,imageon-w3220.yaml
```yaml
# SPDX-License-Identifier: (GPL-2.0-only OR BSD-2-Clause)
%YAML 1.2
---
$id: http://devicetree.org/schemas/display/amd,imageon-w3220.yaml#
$schema: http://devicetree.org/meta-schemas/core.yaml#

title: ATI/AMD Imageon W3220 display controller

maintainers:
  - Koen Kooi <koen@dominion.thruhere.net>

description:
  The W3220 ("w32xx") is one of the ATI/AMD Imageon family of external
  display controllers used on several mid-2000s PDAs (HP iPAQ hx4700),
  hanging off a static-memory chip select as a plain memory-mapped 32-bit
  device -- there is no host LCD controller involved at all, this chip
  drives the panel's own parallel RGB interface directly out of its own
  on-chip SDRAM. "amd,imageon" is already the vendor/family compatible
  prefix upstream uses for this same IP lineage on a different piece of
  silicon (drivers/gpu/drm/msm/adreno/adreno_device.c's imx5 GPU core,
  descended from the same ATI Imageon graphics IP before AMD sold the
  mobile GPU business to Qualcomm in 2009); this binding follows that
  existing "amd,imageon-<part>" shape for the standalone companion-chip
  side of the same family rather than inventing an unrelated prefix.

properties:
  compatible:
    const: amd,imageon-w3220

  reg:
    minItems: 3
    items:
      - description:
          The chip's 16-byte indirect CIF configuration window (chip
          offset 0).
      - description:
          The chip's 8 KiB memory-mapped register window (chip offset
          0x10000).
      - description:
          The video memory window, anchored at the chip-internal address
          the driver programs its memory controller to place pixel data
          at (chip offset 0x800000). This is the whole of the chip's
          on-chip SDRAM as its memory controller maps it, not just the
          primary framebuffer. The scanout buffer for the largest
          supported mode occupies the bottom of the window and the
          hardware video overlay's own source buffers live above it,
          because the overlay's source address register is a
          chip-internal address and the chip has no bus-master path to
          system memory.
      - description:
          The CIF wrap aperture (chip offset 0x80000), a second, smaller
          host-side view onto part of the same on-chip SDRAM. Writes into
          it are redirected by the chip's wrap unit to whatever
          chip-internal address its wrap-buffer register names, which is
          how the host reaches the command processor's ring buffer -- the
          ring lives in video memory, but the command processor and the
          host address it differently. Optional, and needed only for
          command-processor command submission; a device tree that omits
          it gets a driver that programs the 2D engine by polled register
          writes instead.

  reg-names:
    minItems: 3
    items:
      - const: cfg
      - const: reg
      - const: fb
      - const: wrap

  reset-gpios:
    maxItems: 1
    description:
      The chip's own active-low reset line, deasserted once at probe and
      never toggled again.

  sqn-gpios:
    maxItems: 1
    description: Panel sequence-enable line, active-high.

  lvdd-gpios:
    maxItems: 1
    description: Panel logic-supply (3.3 V) enable, active-high.

  avdd-gpios:
    maxItems: 1
    description: Panel analog-supply (3.3 V) enable, active-high.

  slin1-gpios:
    maxItems: 1
    description: Panel serial-interface control line, active-high.

  panel-reset-gpios:
    maxItems: 1
    description:
      The panel's own active-low reset line -- distinct from
      reset-gpios above, which resets the W3220 chip itself, not the
      panel.

  pc1-gpios:
    maxItems: 1
    description: Panel control line, active-high.

  n2v7-gpios:
    maxItems: 1
    description: Panel negative-supply (-7.3 V) enable, active-high.

  backlight:
    $ref: /schemas/types.yaml#/definitions/phandle
    description:
      The backlight that illuminates the attached panel, switched off
      whenever the display is blanked.

required:
  - compatible
  - reg
  - reg-names
  - reset-gpios
  - sqn-gpios
  - lvdd-gpios
  - avdd-gpios
  - slin1-gpios
  - panel-reset-gpios
  - pc1-gpios
  - n2v7-gpios

additionalProperties: false

examples:
  - |
    #include <dt-bindings/gpio/gpio.h>

    display@8000000 {
        compatible = "amd,imageon-w3220";
        reg = <0x08000000 0x10>, <0x08010000 0x2000>, <0x08800000 0x200000>,
              <0x08080000 0x40000>;
        reg-names = "cfg", "reg", "fb", "wrap";

        reset-gpios = <&gpio 61 GPIO_ACTIVE_LOW>;

        sqn-gpios = <&gpio 84 GPIO_ACTIVE_HIGH>;
        lvdd-gpios = <&gpio 110 GPIO_ACTIVE_HIGH>;
        avdd-gpios = <&gpio 111 GPIO_ACTIVE_HIGH>;
        slin1-gpios = <&gpio 70 GPIO_ACTIVE_HIGH>;
        panel-reset-gpios = <&gpio 62 GPIO_ACTIVE_LOW>;
        pc1-gpios = <&gpio 59 GPIO_ACTIVE_HIGH>;
        n2v7-gpios = <&gpio 112 GPIO_ACTIVE_HIGH>;
        backlight = <&backlight>;
    };
```

## Documentation/devicetree/bindings/display/intel,sa1100-lcdc.yaml
```yaml
# SPDX-License-Identifier: GPL-2.0-only OR BSD-2-Clause
%YAML 1.2
---
$id: http://devicetree.org/schemas/display/intel,sa1100-lcdc.yaml#
$schema: http://devicetree.org/meta-schemas/core.yaml#

title: Intel/StrongARM SA-1100 LCD controller

maintainers:
  - Koen Kooi <koen@dominion.thruhere.net>

description: |
  The LCD controller integrated in the Intel/StrongARM SA-1100 and SA-1110
  application processors, driving a parallel RGB (DPI) panel connected
  through the "port" of the OF graph. SA-1100 and SA-1110 share the
  identical register block; "intel,sa1100-lcdc" is the fallback compatible
  for both.

  Unlike marvell,pxa2xx-lcdc's frame-descriptor DMA engine, this
  controller has a single pair of DMA base-address registers (DBAR1/
  DBAR2) and re-reads them at the start of every frame on its own; there
  is no descriptor to chain and this binding describes no such thing.

properties:
  $nodename:
    pattern: "^lcd-controller@[0-9a-f]+$"

  compatible:
    items:
      - const: intel,sa1110-lcdc
      - const: intel,sa1100-lcdc

  reg:
    maxItems: 1

  interrupts:
    maxItems: 1

  clocks:
    maxItems: 1
    description:
      The clock this controller's pixel-clock divider runs from. On both
      SA-1100 and SA-1110 this is the core clock (CCLK), the PLL output
      that clocks the CPU core, not a dedicated LCD PLL.

  port:
    $ref: /schemas/graph.yaml#/$defs/port-base
    unevaluatedProperties: false
    description:
      Connection to the panel or bridge.

    properties:
      endpoint:
        $ref: /schemas/media/video-interfaces.yaml#
        unevaluatedProperties: false

        properties:
          bus-width:
            const: 16
            description:
              Output bit width. In active (TFT) mode the controller drives
              all 16 data lines, LDD<15:0>, one RGB565 pixel per clock.

required:
  - compatible
  - reg
  - interrupts
  - clocks
  - port

additionalProperties: false

examples:
  - |
    #include <dt-bindings/clock/intel,sa1100-clocks.h>

    lcd-controller@b0100000 {
        compatible = "intel,sa1110-lcdc", "intel,sa1100-lcdc";
        reg = <0xb0100000 0x2c>;
        interrupts = <12>;
        clocks = <&clks SA1100_CLK_CPU>;

        port {
            lcdc_out: endpoint {
                remote-endpoint = <&panel_in>;
                bus-width = <16>;
            };
        };
    };
```
