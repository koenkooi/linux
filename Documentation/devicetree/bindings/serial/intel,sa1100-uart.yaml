## Documentation/devicetree/bindings/serial/intel,sa1100-uart.yaml
```yaml
# SPDX-License-Identifier: GPL-2.0-only OR BSD-2-Clause
%YAML 1.2
---
$id: http://devicetree.org/schemas/serial/intel,sa1100-uart.yaml#
$schema: http://devicetree.org/meta-schemas/core.yaml#

title: Intel SA-1100/SA-1110 UART

maintainers:
  - Koen Kooi <koen@dominion.thruhere.net>

description: >-
  One of the on-chip UARTs of the SA-1100/SA-1110 (Ser1, Ser2 and Ser3).
  Ser1 is absent on a board that uses its pins as plain GPIO.

allOf:
  - $ref: serial.yaml#

properties:
  compatible:
    items:
      - const: intel,sa1110-uart
      - const: intel,sa1100-uart

  reg:
    maxItems: 1

  interrupts:
    maxItems: 1

  vcc-supply:
    description: >-
      Regulator powering the external RS232 line driver of this port, on a
      board where it is software-switchable.

required:
  - compatible
  - reg
  - interrupts

unevaluatedProperties: false

examples:
  - |
    #include <dt-bindings/gpio/gpio.h>
    serial@80050000 {
        compatible = "intel,sa1110-uart", "intel,sa1100-uart";
        reg = <0x80050000 0x24>;
        interrupts = <17>;
        vcc-supply = <&rs232_vcc>;
        dcd-gpios = <&gpio 23 GPIO_ACTIVE_LOW>;
        cts-gpios = <&gpio 25 GPIO_ACTIVE_LOW>;
        rts-gpios = <&gpio 26 GPIO_ACTIVE_LOW>;
    };

...
```

## Documentation/devicetree/bindings/sound/asahi-kasei,ak4535.yaml
```yaml
# SPDX-License-Identifier: (GPL-2.0-only OR BSD-2-Clause)
%YAML 1.2
---
$id: http://devicetree.org/schemas/sound/asahi-kasei,ak4535.yaml#
$schema: http://devicetree.org/meta-schemas/core.yaml#

title: Asahi Kasei AK4535 audio CODEC

maintainers:
  - Koen Kooi <koen@dominion.thruhere.net>

description: >-
  AK4535 is an I2C-controlled stereo audio CODEC with a separate I2S (or
  MSB-justified) digital audio interface, found on the HP iPAQ h5xxx
  (h51xx/h54xx/h55xx) among other mid-2000s PDA designs. It has no reset
  pin and no supply-enable of its own: any supply and mute switching is a
  board-level function, and the chip must already be powered before its
  registers are accessed.

properties:
  compatible:
    const: asahi-kasei,ak4535

  reg:
    maxItems: 1

  "#sound-dai-cells":
    const: 0

required:
  - compatible
  - reg

unevaluatedProperties: false

allOf:
  - $ref: dai-common.yaml#

examples:
  - |
    i2c {
        #address-cells = <1>;
        #size-cells = <0>;

        codec@10 {
            compatible = "asahi-kasei,ak4535";
            reg = <0x10>;

            #sound-dai-cells = <0>;
        };
    };
```

## Documentation/devicetree/bindings/sound/hp,ipaq-h2200-audio.yaml
```yaml
# SPDX-License-Identifier: (GPL-2.0-only OR BSD-2-Clause)
%YAML 1.2
---
$id: http://devicetree.org/schemas/sound/hp,ipaq-h2200-audio.yaml#
$schema: http://devicetree.org/meta-schemas/core.yaml#

title: HP iPAQ h2200 audio machine

maintainers:
  - Koen Kooi <koen@dominion.thruhere.net>

description:
  ASoC machine (card) driver for the HP iPAQ h2200 (h2210/h2212/h2215),
  binding the SoC's I2S controller to an onboard Philips/NXP UDA1380
  codec, plus four board GPIOs for speaker, microphone and jack detect
  handling.

  The speaker amplifier enable and the TDA mode pin are driven as a
  complementary raw pin pair from one DAPM event, and the microphone bias
  has no codec-side widget, so a simple-audio-card node cannot describe
  this board.

properties:
  compatible:
    const: hp,ipaq-h2200-audio

  cpu-dai:
    $ref: /schemas/types.yaml#/definitions/phandle
    description:
      Phandle to the PXA I2S controller node. It is also the card's
      platform component, since the I2S driver registers a combined CPU
      DAI and PCM platform.

  audio-codec:
    $ref: /schemas/types.yaml#/definitions/phandle
    description:
      Phandle to the UDA1380 codec node.

  speaker-gpios:
    maxItems: 1
    description:
      Onboard mono speaker amplifier enable, active-high.

  tda-mode-gpios:
    maxItems: 1
    description:
      Driven as a complementary pair with speaker-gpios, never
      independently. The raw pins are speaker=1, tda-mode=0 to unmute and
      speaker=0, tda-mode=1 to mute, so this is declared active-low to
      let the driver write the same logical value to both.

  mic-gpios:
    maxItems: 1
    description:
      External microphone bias enable, active-low. The bias is external
      to the codec on this board.

  ear-in-gpios:
    maxItems: 1
    description:
      Headphone jack detect, active-high (high means a plug is
      inserted). It is a pin of the HAMCOP companion chip rather than a
      SoC GPIO.

required:
  - compatible
  - cpu-dai
  - audio-codec
  - speaker-gpios
  - tda-mode-gpios
  - mic-gpios
  - ear-in-gpios

additionalProperties: false

examples:
  - |
    #include <dt-bindings/gpio/gpio.h>

    sound {
        compatible = "hp,ipaq-h2200-audio";

        cpu-dai = <&i2s>;
        audio-codec = <&uda1380>;

        speaker-gpios  = <&gpio 69 GPIO_ACTIVE_HIGH>;
        tda-mode-gpios = <&gpio 65 GPIO_ACTIVE_LOW>;
        mic-gpios      = <&gpio 66 GPIO_ACTIVE_LOW>;
        ear-in-gpios   = <&hamcop 15 GPIO_ACTIVE_HIGH>;
    };
```

## Documentation/devicetree/bindings/sound/hp,ipaq-h3800-audio.yaml
```yaml
# SPDX-License-Identifier: (GPL-2.0-only OR BSD-2-Clause)
%YAML 1.2
---
$id: http://devicetree.org/schemas/sound/hp,ipaq-h3800-audio.yaml#
$schema: http://devicetree.org/meta-schemas/core.yaml#

title: HP iPAQ h3800 audio machine (UDA1341TS over the SA-1110 SSP)

maintainers:
  - Koen Kooi <koen@dominion.thruhere.net>

description: >-
  Audio path of the HP/Compaq iPAQ h38xx family: a UDA1341TS codec
  (nxp,uda1341.yaml) on the SA-1110 Ser4 SSP (intel,sa1100-ssp.yaml), with
  ASIC1 GPIO speaker/headphone routing and audio power, and ASIC2 GPIO2
  jack detect.

  The sample rate is not derived from a single free-running system clock.
  It is selected from four fixed taps of the audio clock selector of ASIC2
  (the "#clock-cells" of htc,asic2.yaml), which feeds the external clock
  input of the SSP, and the SerClkDiv field of the SSP and the STATUS0 SC
  field of the codec have to match the selected tap for the bit clock to
  be 32 fs.

properties:
  compatible:
    const: hp,ipaq-h3800-audio

  cpu:
    type: object
    description: The SSP CPU DAI (intel,sa1100-ssp.yaml).
    additionalProperties: false

    properties:
      sound-dai:
        maxItems: 1

    required:
      - sound-dai

  codec:
    type: object
    description: The UDA1341TS codec (nxp,uda1341.yaml).
    additionalProperties: false

    properties:
      sound-dai:
        maxItems: 1

    required:
      - sound-dai

  clocks:
    maxItems: 1
    description: >-
      The audio-clock tap selector of ASIC2 (the "#clock-cells" of
      htc,asic2.yaml), which provides one of four fixed rates; the rate
      fields of the SSP and the codec have to match the selected tap.

  clock-names:
    items:
      - const: audio

  spk-gpios:
    maxItems: 1
    description: >-
      ASIC1 SPK_ON. Not an independent enable: the speaker and headphone
      routing is a truth table shared with ear-gpios.

  ear-gpios:
    maxItems: 1
    description: ASIC1 EAR_ON_N. See spk-gpios.

  aud-pwr-gpios:
    maxItems: 1
    description: >-
      ASIC1 AUD_PWR_ON, the supply rail of the codec.

  jack-gpios:
    maxItems: 1
    description: >-
      ASIC2 GPIO2 bit 7 (EAR_IN_N), active-low. It is also the jack-detect
      interrupt source; the gpio-controller of ASIC2 is also an interrupt
      controller for this line.

required:
  - compatible
  - cpu
  - codec
  - clocks
  - clock-names
  - spk-gpios
  - ear-gpios
  - aud-pwr-gpios
  - jack-gpios

additionalProperties: false

examples:
  - |
    #include <dt-bindings/clock/htc,asic2.h>
    #include <dt-bindings/gpio/gpio.h>

    sound {
        compatible = "hp,ipaq-h3800-audio";

        clocks = <&asic2 ASIC2_CLK_AUDIO>;
        clock-names = "audio";

        spk-gpios = <&asic1 12 GPIO_ACTIVE_HIGH>;
        ear-gpios = <&asic1 13 GPIO_ACTIVE_HIGH>;
        aud-pwr-gpios = <&asic1 14 GPIO_ACTIVE_HIGH>;
        jack-gpios = <&asic2 7 GPIO_ACTIVE_LOW>;

        cpu {
            sound-dai = <&ssp>;
        };

        codec {
            sound-dai = <&uda1341>;
        };
    };

...
```

## Documentation/devicetree/bindings/sound/hp,ipaq-h3900-audio.yaml
```yaml
# SPDX-License-Identifier: (GPL-2.0-only OR BSD-2-Clause)
%YAML 1.2
---
$id: http://devicetree.org/schemas/sound/hp,ipaq-h3900-audio.yaml#
$schema: http://devicetree.org/meta-schemas/core.yaml#

title: HP iPAQ h3900 audio

maintainers:
  - Koen Kooi <koen@dominion.thruhere.net>

description: >-
  The audio subsystem of the HP iPAQ h3950/h3955/h3970/h3975 family: the
  SoC's I2S controller (marvell,pxa2xx-i2s.yaml) wired to an onboard NXP
  UDA1380 codec (nxp,uda1380.yaml), with the SoC driving the bit and frame
  clocks. The codec's reset and power lines and the speaker amplifier
  enable are outputs of the board's ASIC3 companion chip rather than SoC
  pins. The only microphone is a built-in electret on the codec's VINM/LNA
  input, biased by the codec itself; there is no board GPIO, regulator or
  microphone jack for it.

properties:
  compatible:
    const: hp,ipaq-h3900-audio

  cpu-dai:
    $ref: /schemas/types.yaml#/definitions/phandle
    description:
      Phandle to the PXA I2S controller node (marvell,pxa2xx-i2s.yaml).

  audio-codec:
    $ref: /schemas/types.yaml#/definitions/phandle
    description:
      Phandle to the UDA1380 codec node (nxp,uda1380.yaml).

  speaker-gpios:
    maxItems: 1
    description:
      Enable for the speaker amplifier (SPK_ON), an ASIC3 output.

  jack-gpios:
    maxItems: 1
    description:
      Headphone jack detect, ASIC2 GPIO2 bit 7 (EAR_IN_N). Asserted (low)
      when a plug is inserted.

required:
  - compatible
  - cpu-dai
  - audio-codec
  - speaker-gpios

additionalProperties: false

examples:
  - |
    #include <dt-bindings/gpio/gpio.h>

    sound {
        compatible = "hp,ipaq-h3900-audio";

        cpu-dai = <&i2s>;
        audio-codec = <&uda1380>;

        speaker-gpios = <&asic3 28 GPIO_ACTIVE_HIGH>;
        jack-gpios = <&asic2 7 GPIO_ACTIVE_LOW>;
    };
```

## Documentation/devicetree/bindings/sound/hp,ipaq-h5000-audio.yaml
```yaml
# SPDX-License-Identifier: (GPL-2.0-only OR BSD-2-Clause)
%YAML 1.2
---
$id: http://devicetree.org/schemas/sound/hp,ipaq-h5000-audio.yaml#
$schema: http://devicetree.org/meta-schemas/core.yaml#

title: HP iPAQ h5xxx audio machine

maintainers:
  - Koen Kooi <koen@dominion.thruhere.net>

description: >-
  The audio subsystem of the HP iPAQ h51xx/h54xx/h55xx family: the SoC's
  I2S controller (marvell,pxa2xx-i2s.yaml) wired to an onboard Asahi Kasei
  AK4535 codec (asahi-kasei,ak4535.yaml), with the PXA driving the bit and
  frame clocks. Because the codec has no supply-enable pin of its own, the
  board gates it externally, and gates the output stage and microphone
  bias behind a second, independent switch downstream of the codec; both
  switches are SAMCOP GPB outputs. A headphone-detect line on a SoC GPIO
  reports jack insertion.

properties:
  compatible:
    const: hp,ipaq-h5000-audio

  cpu-dai:
    $ref: /schemas/types.yaml#/definitions/phandle
    description:
      Phandle to the PXA I2S controller node (marvell,pxa2xx-i2s.yaml).

  audio-codec:
    $ref: /schemas/types.yaml#/definitions/phandle
    description:
      Phandle to the AK4535 codec node (asahi-kasei,ak4535.yaml).

  codec-power-gpios:
    maxItems: 1
    description:
      Supply enable for the AK4535 itself, a SAMCOP GPB output. The codec
      has no supply-enable pin of its own, so this must be asserted and
      settled before any of its registers are accessed.

  audio-power-gpios:
    maxItems: 1
    description:
      Enable for the output-stage and microphone-bias power switch
      downstream of the codec, a second SAMCOP GPB output independent of
      the codec supply above.

  headphone-detect-gpios:
    maxItems: 1
    description:
      Headphone jack detect, a SoC GPIO asserted while a plug is inserted.

required:
  - compatible
  - cpu-dai
  - audio-codec
  - codec-power-gpios
  - audio-power-gpios
  - headphone-detect-gpios

additionalProperties: false

examples:
  - |
    #include <dt-bindings/gpio/gpio.h>

    sound {
        compatible = "hp,ipaq-h5000-audio";

        cpu-dai = <&i2s>;
        audio-codec = <&ak4535>;

        codec-power-gpios     = <&samcop 32 GPIO_ACTIVE_HIGH>;
        audio-power-gpios     = <&samcop 34 GPIO_ACTIVE_HIGH>;
        headphone-detect-gpios = <&gpio 76 GPIO_ACTIVE_HIGH>;
    };
```

## Documentation/devicetree/bindings/sound/intel,sa1100-ssp.yaml
```yaml
# SPDX-License-Identifier: (GPL-2.0-only OR BSD-2-Clause)
%YAML 1.2
---
$id: http://devicetree.org/schemas/sound/intel,sa1100-ssp.yaml#
$schema: http://devicetree.org/meta-schemas/core.yaml#

title: Intel SA-1100/SA-1110 synchronous serial port

maintainers:
  - Koen Kooi <koen@dominion.thruhere.net>

description: |
  The synchronous serial port (SSP) of serial port 4 of the Intel
  StrongARM SA-1100 and SA-1110, used as a digital audio interface. It
  transfers 4 to 16 bit frames in Motorola SPI, Texas Instruments
  synchronous serial or National Microwire format through an 8-entry
  transmit and a 12-entry receive FIFO, is programmed through SSCR0,
  SSCR1, SSDR and SSSR, and raises a single interrupt controller source.
  Its transmit and receive FIFOs are serviced by the DMA request lines
  Ser4SSPTr and Ser4SSPRc.

  The serial clock is derived either from the on-chip 3.6864 MHz
  oscillator or, with the external clock select (ECS) bit of SSCR1 set,
  from a clock supplied by the board on GPIO19. An audio codec needs the
  external clock to reach sample rates that are not a multiple of the
  oscillator frequency. GPIO19 then has to be switched to its SSP_CLK
  alternate function as an input through the pin controller.

  The register layout is identical on both chips, and differs from the
  SSP of the PXA2xx: the ECS bit is in SSCR1 here and in SSCR0 there.

allOf:
  - $ref: dai-common.yaml#

properties:
  compatible:
    items:
      - const: intel,sa1110-ssp
      - const: intel,sa1100-ssp

  reg:
    maxItems: 1

  interrupts:
    maxItems: 1

  clocks:
    maxItems: 1
    description:
      External serial clock input on GPIO19.

  dmas:
    items:
      - description: Ser4SSPTr, transmit
      - description: Ser4SSPRc, receive

  dma-names:
    items:
      - const: tx
      - const: rx

  "#sound-dai-cells":
    const: 0

required:
  - compatible
  - reg
  - interrupts
  - dmas
  - dma-names
  - "#sound-dai-cells"

unevaluatedProperties: false

examples:
  - |
    ssp@80070060 {
        compatible = "intel,sa1110-ssp", "intel,sa1100-ssp";
        reg = <0x80070060 0x18>;
        interrupts = <19>;
        clocks = <&audio_clk>;
        dmas = <&dma 14>, <&dma 15>;
        dma-names = "tx", "rx";
        pinctrl-names = "default";
        pinctrl-0 = <&ssp_clk_pins>;
        #sound-dai-cells = <0>;
    };

...
```
