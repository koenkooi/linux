## Documentation/devicetree/bindings/usb/marvell,pxa270-udc.yaml
```yaml
# SPDX-License-Identifier: (GPL-2.0-only OR BSD-2-Clause)
%YAML 1.2
---
$id: http://devicetree.org/schemas/usb/marvell,pxa270-udc.yaml#
$schema: http://devicetree.org/meta-schemas/core.yaml#

title: Marvell PXA27x USB Device Controller (UDC)

maintainers:
  - Koen Kooi <koen@dominion.thruhere.net>

description: >-
  The full-speed USB Device Controller integrated in the PXA27x application
  processors: endpoint zero and up to 23 configurable endpoints whose type,
  direction and packet size are assigned by software, and an integrated
  transceiver. This is a different block from the PXA25x UDC, which has
  fixed endpoints and its own binding. The D+ pullup resistor is not part of
  the controller; boards that switch it from a GPIO describe that line here.
  The controller connects to the host only while VBUS is present, which is
  reported by the device referenced by usb-phy.

properties:
  compatible:
    const: marvell,pxa270-udc

  reg:
    maxItems: 1

  interrupts:
    maxItems: 1

  clocks:
    maxItems: 1

  gpios:
    maxItems: 1
    description:
      GPIO that connects the D+ pullup resistor, making the device visible
      to the USB host when asserted.

  usb-phy:
    $ref: /schemas/types.yaml#/definitions/phandle
    description:
      Phandle of the device that senses VBUS on the USB connector and reports
      its presence or loss to the controller.

required:
  - compatible
  - reg
  - interrupts
  - clocks
  - usb-phy

additionalProperties: false

examples:
  - |
    #include <dt-bindings/clock/pxa-clock.h>
    #include <dt-bindings/gpio/gpio.h>

    usb_connector: connector {
        compatible = "gpio-usb-b-connector", "usb-b-connector";
        vbus-gpios = <&asic3 62 GPIO_ACTIVE_LOW>;
    };

    udc@40600000 {
        compatible = "marvell,pxa270-udc";
        reg = <0x40600000 0x10000>;
        interrupts = <11>;
        clocks = <&clks CLK_USB>;
        gpios = <&gpio 76 GPIO_ACTIVE_HIGH>;
        usb-phy = <&usb_connector>;
    };

...
```

## Documentation/devicetree/bindings/w1/dallas,ds1wm.yaml
```yaml
# SPDX-License-Identifier: (GPL-2.0-only OR BSD-2-Clause)
%YAML 1.2
---
$id: http://devicetree.org/schemas/w1/dallas,ds1wm.yaml#
$schema: http://devicetree.org/meta-schemas/core.yaml#

title: Dallas DS1WM 1-Wire bus master

maintainers:
  - Koen Kooi <koen@dominion.thruhere.net>

description: >-
  The DS1WM 1-Wire bus master core (drivers/w1/masters/ds1wm.c) as embedded
  in several HP/Compaq iPAQ companion ASICs: ASIC2 (h38xx/h39xx), ASIC3
  (hx4700), HAMCOP (h2200) and SAMCOP (h5xxx). The node has no "reg" and no
  "interrupts" of its own -- the parent MFD core hands this cell its
  register sub-range and demultiplexed interrupt directly, out of band from
  this node -- and its gate clock is resolved by devm_clk_get(dev, NULL)
  against the parent MFD driver's own clkdev alias, which is why this
  binding deliberately carries no "clocks" property.

properties:
  compatible:
    items:
      - enum:
          - htc,asic2-onewire
          - htc,asic3-onewire
          - samsung,hamcop-onewire
          - samsung,samcop-onewire
      - const: dallas,ds1wm

  dallas,bus-shift:
    $ref: /schemas/types.yaml#/definitions/uint32
    enum: [0, 1, 2]
    default: 0
    description: >-
      Register-file stride: logical register N (0=CMD, 1=DATA, 2=INT,
      3=INT_EN, 4=CLKDIV) sits at byte offset N << bus-shift. The driver
      rejects any value above 2. Register access itself is always
      byte-wide regardless of this stride.

  dallas,active-high:
    type: boolean
    description: >-
      Sets DS1WM_INTEN's IAS bit: present when the DS1WM-to-parent-ASIC
      interrupt line is wired active-high, absent when active-low. This is
      chip-internal wiring, not board policy.

  dallas,reset-recover-delay-ms:
    default: 0
    maximum: 10
    description: >-
      Milliseconds to sleep after a 1-Wire bus reset pulse before the next
      transaction. 0 is correct for any 1-Wire-spec-compliant slave --
      DS1WM's own reset/presence-detect timing is already exact.

  battery:
    $ref: /schemas/power/supply/maxim,ds2760.yaml#
    description: >-
      The DS2760 gas gauge in the handheld's battery pack -- on every
      board in this family, the bus's only slave. No slave needs a node
      to be found at all (the w1 core enumerates the bus by family code),
      but a node is what lets one be referenced: "power-supplies" on this
      child is how the gauge learns which charger supplies it, and
      ds2760_battery.c passes dev_fwnode() of the w1 slave device
      straight through to the power_supply it registers. Node placement
      under the bus master is the convention
      Documentation/devicetree/bindings/w1/w1.txt's own example uses.

required:
  - compatible

additionalProperties: false

examples:
  - |
    companion-chip {
        onewire {
            compatible = "htc,asic2-onewire", "dallas,ds1wm";
            dallas,bus-shift = <2>;
            dallas,active-high;
            dallas,reset-recover-delay-ms = <1>;

            battery {
                compatible = "maxim,ds2760";
            };
        };
    };

...
```

## drivers/gpu/drm/tiny/Kconfig
```kconfig
# SPDX-License-Identifier: GPL-2.0-only

config DRM_APPLETBDRM
	tristate "DRM support for Apple Touch Bars"
	depends on DRM && USB && MMU
	depends on X86 || COMPILE_TEST
	select DRM_GEM_SHMEM_HELPER
	select DRM_KMS_HELPER
	help
	  Say Y here if you want support for the display of Touch Bars on x86
	  MacBook Pros.

	  To compile this driver as a module, choose M here: the
	  module will be called appletbdrm.

config DRM_ARCPGU
	tristate "ARC PGU"
	depends on DRM && OF
	select DRM_CLIENT_SELECTION
	select DRM_GEM_DMA_HELPER
	select DRM_KMS_HELPER
	help
	  Choose this option if you have an ARC PGU controller.

	  If M is selected the module will be called arcpgu.

config DRM_BOCHS
	tristate "DRM Support for bochs dispi vga interface (qemu stdvga)"
	depends on DRM && PCI && MMU
	select DRM_CLIENT_SELECTION
	select DRM_GEM_SHMEM_HELPER
	select DRM_KMS_HELPER
	help
	  This is a KMS driver for qemu's stdvga output. Choose this option
	  for qemu.

	  If M is selected the module will be called bochs.

config DRM_CIRRUS_QEMU
	tristate "Cirrus driver for QEMU emulated device"
	depends on DRM && PCI
	select DRM_CLIENT_SELECTION
	select DRM_KMS_HELPER
	select DRM_GEM_SHMEM_HELPER
	help
	 This is a KMS driver for emulated cirrus device in qemu.
	 It is *NOT* intended for real cirrus devices. This requires
	 the modesetting userspace X.org driver.

	 Cirrus is obsolete, the hardware was designed in the 90ies
	 and can't keep up with todays needs.  More background:
	 https://www.kraxel.org/blog/2014/10/qemu-using-cirrus-considered-harmful/

	 Better alternatives are:
	   - stdvga (DRM_BOCHS, qemu -vga std, default in qemu 2.2+)
	   - qxl (DRM_QXL, qemu -vga qxl, works best with spice)
	   - virtio (DRM_VIRTIO_GPU), qemu -vga virtio)

config DRM_GM12U320
	tristate "GM12U320 driver for USB projectors"
	depends on DRM && USB && MMU
	select DRM_CLIENT_SELECTION
	select DRM_KMS_HELPER
	select DRM_GEM_SHMEM_HELPER
	help
	 This is a KMS driver for projectors which use the GM12U320 chipset
	 for video transfer over USB2/3, such as the Acer C120 mini projector.

config DRM_MQ11XX
	tristate "DRM support for the MediaQ 11xx family (HP iPAQ h2200/h5xxx)"
	depends on DRM && ARCH_PXA && MMU
	select AUXILIARY_BUS
	select BACKLIGHT_CLASS_DEVICE
	select DRM_CLIENT_SELECTION
	select DRM_KMS_HELPER
	select DRM_GEM_SHMEM_HELPER
	imply PWM
	help
	  DRM driver for the MediaQ 11xx family of external display
	  controllers (1100/1132/1178) used as the sole display path on
	  the HP iPAQ h2200 and h5xxx families -- the PXA25x's own LCD
	  controller is unwired on both. Fixed-resolution RGB565 panel,
	  memory-mapped off a PXA static memory bank, board-specific
	  geometry and register table selected by the devicetree compatible.

	  The h5xxx backlight is controlled by the internal PWM of the
	  chip, which the driver exports as a PWM chip when PWM support
	  is enabled.

	  If M is selected the module will be called mq11xx.

config DRM_PANEL_MIPI_DBI
	tristate "DRM support for MIPI DBI compatible panels"
	depends on DRM && SPI
	select DRM_CLIENT_SELECTION
	select DRM_KMS_HELPER
	select DRM_GEM_DMA_HELPER
	select DRM_MIPI_DBI
	select BACKLIGHT_CLASS_DEVICE
	select VIDEOMODE_HELPERS
	help
	  Say Y here if you want to enable support for MIPI DBI compatible
	  panels. The controller command setup can be provided using a
	  firmware file. For more information see
	  https://github.com/notro/panel-mipi-dbi/wiki.
	  To compile this driver as a module, choose M here.

config DRM_PIXPAPER
        tristate "DRM support for PIXPAPER display panels"
        depends on DRM && SPI
        depends on MMU
        select DRM_CLIENT_SELECTION
        select DRM_GEM_SHMEM_HELPER
        select DRM_KMS_HELPER
        help
	  DRM driver for the Mayqueen Pixpaper e-ink display panel.

	  This driver supports small e-paper displays connected over SPI,
	  with a resolution of 122x250 and XRGB8888 framebuffer format.
	  It is intended for low-power embedded applications.

	  If M is selected, the module will be built as pixpaper.ko.

config DRM_SA11X0_LCDC
	tristate "DRM support for the Intel/StrongARM SA-1100 LCD controller"
	depends on DRM && OF
	depends on ARCH_SA1100 || COMPILE_TEST
	depends on COMMON_CLK
	depends on MMU
	select DRM_CLIENT_SELECTION
	select DRM_KMS_HELPER
	select DRM_GEM_DMA_HELPER
	select DRM_PANEL_BRIDGE
	help
	  DRM driver for the LCD controller integrated in the Intel/
	  StrongARM SA-1100 and SA-1110 application processors, driving a
	  parallel RGB (DPI) panel described in the device tree. This
	  controller has a single DMA base-address register with no
	  descriptor to chain, but requires a small fixed pixel-format header to precede
	  the pixel data in memory, so this driver copies each update into
	  one persistent shadow buffer rather than scanning out of the GEM
	  object directly.

	  Panel supplies and timings belong to a drm_panel driver reached
	  over the OF graph, not to this driver. The legacy fbdev driver for
	  the same hardware, CONFIG_FB_SA1100, binds to the platform device
	  that a board file registers and does not match a device tree node.

	  If M is selected the module will be called sa1100-lcdc.

config TINYDRM_HX8357D
	tristate "DRM support for HX8357D display panels"
	depends on DRM && SPI
	select DRM_CLIENT_SELECTION
	select DRM_KMS_HELPER
	select DRM_GEM_DMA_HELPER
	select DRM_MIPI_DBI
	select BACKLIGHT_CLASS_DEVICE
	help
	  DRM driver for the following HX8357D panels:
	  * YX350HV15-T 3.5" 340x350 TFT (Adafruit 3.5")

	  If M is selected the module will be called hx8357d.

config TINYDRM_ILI9163
	tristate "DRM support for ILI9163 display panels"
	depends on DRM && SPI
	select BACKLIGHT_CLASS_DEVICE
	select DRM_CLIENT_SELECTION
	select DRM_GEM_DMA_HELPER
	select DRM_KMS_HELPER
	select DRM_MIPI_DBI
	help
	  DRM driver for the following Ilitek ILI9163 panels:
	  * NHD-1.8-128160EF 128x160 TFT

	  If M is selected the module will be called ili9163.

config TINYDRM_ILI9225
	tristate "DRM support for ILI9225 display panels"
	depends on DRM && SPI
	select DRM_CLIENT_SELECTION
	select DRM_KMS_HELPER
	select DRM_GEM_DMA_HELPER
	select DRM_MIPI_DBI
	help
	  DRM driver for the following Ilitek ILI9225 panels:
	  * No-name 2.2" color screen module

	  If M is selected the module will be called ili9225.

config TINYDRM_ILI9341
	tristate "DRM support for ILI9341 display panels"
	depends on DRM && SPI
	select DRM_CLIENT_SELECTION
	select DRM_KMS_HELPER
	select DRM_GEM_DMA_HELPER
	select DRM_MIPI_DBI
	select BACKLIGHT_CLASS_DEVICE
	help
	  DRM driver for the following Ilitek ILI9341 panels:
	  * YX240QV29-T 2.4" 240x320 TFT (Adafruit 2.4")

	  If M is selected the module will be called ili9341.

config TINYDRM_ILI9486
	tristate "DRM support for ILI9486 display panels"
	depends on DRM && SPI
	select DRM_CLIENT_SELECTION
	select DRM_KMS_HELPER
	select DRM_GEM_DMA_HELPER
	select DRM_MIPI_DBI
	select BACKLIGHT_CLASS_DEVICE
	help
	  DRM driver for the following Ilitek ILI9486 panels:
	  * PISCREEN 3.5" 320x480 TFT (Ozzmaker 3.5")
	  * RPILCD 3.5" 320x480 TFT (Waveshare 3.5")

	  If M is selected the module will be called ili9486.

config TINYDRM_MI0283QT
	tristate "DRM support for MI0283QT"
	depends on DRM && SPI
	select DRM_CLIENT_SELECTION
	select DRM_KMS_HELPER
	select DRM_GEM_DMA_HELPER
	select DRM_MIPI_DBI
	select BACKLIGHT_CLASS_DEVICE
	help
	  DRM driver for the Multi-Inno MI0283QT display panel
	  If M is selected the module will be called mi0283qt.

config TINYDRM_REPAPER
	tristate "DRM support for Pervasive Displays RePaper panels (V231)"
	depends on DRM && SPI
	select DRM_CLIENT_SELECTION
	select DRM_KMS_HELPER
	select DRM_GEM_DMA_HELPER
	help
	  DRM driver for the following Pervasive Displays panels:
	  1.44" TFT EPD Panel (E1144CS021)
	  1.90" TFT EPD Panel (E1190CS021)
	  2.00" TFT EPD Panel (E2200CS021)
	  2.71" TFT EPD Panel (E2271CS021)

	  If M is selected the module will be called repaper.

config TINYDRM_SHARP_MEMORY
	tristate "DRM support for Sharp Memory LCD panels"
	depends on DRM && SPI
	select DRM_CLIENT_SELECTION
	select DRM_GEM_DMA_HELPER
	select DRM_KMS_HELPER
	help
	  DRM Driver for the following Sharp Memory Panels:
	  * 1.00" Sharp Memory LCD (LS010B7DH04)
	  * 1.10" Sharp Memory LCD (LS011B7DH03)
	  * 1.20" Sharp Memory LCD (LS012B7DD01)
	  * 1.28" Sharp Memory LCD (LS013B7DH03)
	  * 1.26" Sharp Memory LCD (LS013B7DH05)
	  * 1.80" Sharp Memory LCD (LS018B7DH02)
	  * 2.70" Sharp Memory LCD (LS027B7DH01)
	  * 2.70" Sharp Memory LCD (LS027B7DH01A)
	  * 3.20" Sharp Memory LCD (LS032B7DD02)
	  * 4.40" Sharp Memory LCD (LS044Q7DH01)

	  If M is selected the module will be called sharp_memory.
```

## drivers/media/mmc/veo/Kconfig
```kconfig
# SPDX-License-Identifier: GPL-2.0-only

config VIDEO_VEO_SDIOCAM
	tristate "HP Photosmart Mobile / Veo SDIO camera"
	depends on MMC && VIDEO_DEV && MEDIA_CAMERA_SUPPORT
	select VIDEOBUF2_VMALLOC
	select FW_LOADER
	help
	  V4L2 driver for the HP Photosmart Mobile Camera (FA185A), an SDIO
	  card built around a Veo camera bridge (SDIO vendor 0x030d,
	  device 0x0000). Frames are baseline JPEG, offered as V4L2_PIX_FMT_JPEG
	  (with Huffman tables) and V4L2_PIX_FMT_MJPEG (without).

	  The card needs the 1620-byte initialisation table of the factory
	  driver as /lib/firmware/veo/hpcamera-init.bin.

	  Frames whose JPEG data is incomplete are dropped, not delivered.

	  To compile this driver as a module, choose M here: the module will
	  be called veo_sdiocam.

config VIDEO_VEO_SDIOCAM_KUNIT_TEST
	bool "KUnit tests for the Veo SDIO camera JPEG helpers" if !KUNIT_ALL_TESTS
	depends on KUNIT && VIDEO_VEO_SDIOCAM
	depends on KUNIT=y || VIDEO_VEO_SDIOCAM=m
	default KUNIT_ALL_TESTS
	help
	  Tests for the JPEG header builder and the frame validator of the
	  veo_sdiocam driver, built into that module. They use synthetic
	  scans only and need no camera.

	  If unsure, say N.
```
