## Documentation/devicetree/bindings/pcmcia/hp,ipaq-h3900-pcmcia.yaml
```yaml
# SPDX-License-Identifier: (GPL-2.0-only OR BSD-2-Clause)
%YAML 1.2
---
$id: http://devicetree.org/schemas/pcmcia/hp,ipaq-h3900-pcmcia.yaml#
$schema: http://devicetree.org/meta-schemas/core.yaml#

title: HP iPAQ h3900 CompactFlash sockets

maintainers:
  - Koen Kooi <koen@dominion.thruhere.net>

description: |
  The CompactFlash sockets of the HP iPAQ h3900 family. The h3900 has no
  slot of its own: the sockets sit in an expansion pack ("sleeve" or
  "option jacket") clipped onto the base connector, and their address and
  data signals pass straight through to the PXA25x's own PC Card sockets,
  whose pins the board muxes. The node has no register window or interrupt
  of its own and describes the control lines around that interface. The
  driver registers the sockets only once a pack that carries a
  CompactFlash or PC Card slot has been detected.

  Card detect and the card's ready/interrupt request line are SoC GPIO
  inputs, one pair per socket. Only the first socket has a reset line of
  its own.

properties:
  $nodename:
    const: pcmcia

  compatible:
    const: hp,ipaq-h3900-pcmcia

  detect-gpios:
    maxItems: 1
    description:
      Card detect of socket 0 (PCMCIA_CD0_N), low while a card is seated.
      It reads as low only after the pack is powered. Must be usable as an
      interrupt source.

  ready-gpios:
    maxItems: 1
    description:
      Ready/busy for memory cards and interrupt request for I/O cards of
      socket 0 (PCMCIA_IRQ0_N). Must be usable as an interrupt source.

  detect1-gpios:
    maxItems: 1
    description:
      Card detect of socket 1 (PCMCIA_CD1_N), low while a card is seated.
      Must be usable as an interrupt source.

  ready1-gpios:
    maxItems: 1
    description:
      Ready/busy for memory cards and interrupt request for I/O cards of
      socket 1 (PCMCIA_IRQ1_N). Must be usable as an interrupt source.

  reset-gpios:
    maxItems: 1
    description:
      The reset of the card in socket 0 (OPT_PCM_RESET), as opposed to the
      reset of the whole pack that the sleeve node describes.

required:
  - compatible
  - detect-gpios
  - ready-gpios
  - detect1-gpios
  - ready1-gpios
  - reset-gpios

additionalProperties: false

examples:
  - |
    #include <dt-bindings/gpio/gpio.h>

    pcmcia {
        compatible = "hp,ipaq-h3900-pcmcia";

        detect-gpios = <&gpio 3 GPIO_ACTIVE_LOW>;
        ready-gpios = <&gpio 7 GPIO_ACTIVE_HIGH>;
        detect1-gpios = <&gpio 12 GPIO_ACTIVE_LOW>;
        ready1-gpios = <&gpio 13 GPIO_ACTIVE_HIGH>;
        reset-gpios = <&gpio 8 GPIO_ACTIVE_HIGH>;
    };
...
```

## Documentation/devicetree/bindings/pcmcia/hp,ipaq-h5000-pcmcia.yaml
```yaml
# SPDX-License-Identifier: (GPL-2.0-only OR BSD-2-Clause)
%YAML 1.2
---
$id: http://devicetree.org/schemas/pcmcia/hp,ipaq-h5000-pcmcia.yaml#
$schema: http://devicetree.org/meta-schemas/core.yaml#

title: HP iPAQ h5000 CompactFlash socket

maintainers:
  - Koen Kooi <koen@dominion.thruhere.net>

description: |
  The CompactFlash socket of the HP iPAQ h5000 family. The h5000 has no
  slot of its own: the socket sits in an expansion pack ("sleeve") clipped
  onto the base connector, and its address and data signals pass straight
  through to the first of the PXA25x's PC Card sockets, whose pins the
  board muxes.

  The socket's card detect, card interrupt and card reset are not SoC
  GPIOs. They are bits of the expansion-pack status and control register
  of the SAMCOP companion chip, which the SAMCOP sleeve node of the same
  board provides to the socket driver. The node therefore has no GPIO
  properties, register window or interrupt of its own and exists to
  describe the socket's presence on the board. The driver registers the
  socket only once a sleeve that carries a CompactFlash or PC Card slot
  has been detected.

properties:
  $nodename:
    const: pcmcia

  compatible:
    const: hp,ipaq-h5000-pcmcia

required:
  - compatible

additionalProperties: false

examples:
  - |
    pcmcia {
        compatible = "hp,ipaq-h5000-pcmcia";
    };
...
```

## Documentation/devicetree/bindings/pcmcia/hp,ipaq-hx4700-pcmcia.yaml
```yaml
# SPDX-License-Identifier: (GPL-2.0-only OR BSD-2-Clause)
%YAML 1.2
---
$id: http://devicetree.org/schemas/pcmcia/hp,ipaq-hx4700-pcmcia.yaml#
$schema: http://devicetree.org/meta-schemas/core.yaml#

title: HP iPAQ hx4700 CompactFlash socket

maintainers:
  - Koen Kooi <koen@dominion.thruhere.net>

description: |
  The CompactFlash socket of the HP iPAQ hx4700, wired to the first of the
  PXA27x's PC Card sockets. The card's address and data signals ride the
  SoC's own PC Card interface, whose pins the board muxes, but they are
  buffered by the ASIC3 companion chip, so the node has no register window
  or interrupt of its own. The socket driver programs the buffering through
  the ASIC3 node the "hp,asic3" property points to.

  Card detect is an ASIC3 GPIO input. The ready/interrupt line and the
  card's reset are SoC GPIOs, and the supply of the socket is an output of
  the EGPIO expander.

properties:
  $nodename:
    const: pcmcia

  compatible:
    const: hp,ipaq-hx4700-pcmcia

  hp,asic3:
    $ref: /schemas/types.yaml#/definitions/phandle
    description:
      Phandle to the ASIC3 node (htc,asic3.yaml) that buffers the socket's
      bus and whose GPIO banks carry the PC Card control signals.

  detect-gpios:
    maxItems: 1
    description:
      Card detect (CF_nCD), low while a card is seated. Must be usable as an
      interrupt source so that insertion and removal are noticed.

  ready-gpios:
    maxItems: 1
    description:
      The card's ready/busy indication for memory cards and interrupt
      request for I/O cards (CF_RNB). Must be usable as an interrupt
      source.

  reset-gpios:
    maxItems: 1
    description:
      The card's RESET pin (CF_RESET).

  power-gpios:
    maxItems: 1
    description:
      Enable for the socket's 3.3 V supply (CF_3V3_ON).

required:
  - compatible
  - hp,asic3
  - detect-gpios
  - ready-gpios
  - reset-gpios
  - power-gpios

additionalProperties: false

examples:
  - |
    #include <dt-bindings/gpio/gpio.h>

    pcmcia {
        compatible = "hp,ipaq-hx4700-pcmcia";

        hp,asic3 = <&asic3>;
        detect-gpios = <&asic3 52 GPIO_ACTIVE_LOW>;
        ready-gpios = <&gpio 60 GPIO_ACTIVE_HIGH>;
        reset-gpios = <&gpio 114 GPIO_ACTIVE_HIGH>;
        power-gpios = <&egpio0 4 GPIO_ACTIVE_HIGH>;
    };
...
```

## Documentation/devicetree/bindings/pcmcia/intel,sa1110-pcmcia.yaml
```yaml
# SPDX-License-Identifier: (GPL-2.0-only OR BSD-2-Clause)
%YAML 1.2
---
$id: http://devicetree.org/schemas/pcmcia/intel,sa1110-pcmcia.yaml#
$schema: http://devicetree.org/meta-schemas/core.yaml#

title: Intel SA-1110 PC Card / CompactFlash socket

maintainers:
  - Koen Kooi <koen@dominion.thruhere.net>

description: |
  One of the two PC Card sockets the SA-1110's expansion memory bus
  decodes. Each socket has a fixed 256 MiB window -- socket 0 at
  0x20000000, socket 1 at 0x30000000 -- split into four equal 64 MiB
  partitions: I/O, reserved, attribute memory, common memory. The window
  is the socket's identity: the unit address says which socket a node is.

  Access timing for both sockets lives in a single register, MECR, in the
  memory controller's register block, as two sets of per-socket bit
  fields in one shared word rather than one register per socket. It is
  not described here, for the same reason the static memory controller
  binding (intel,sa1110-smc.yaml) excludes it from its own
  reg list: it belongs to neither node exclusively.

  Card detect, ready/IRQ, the battery-voltage-detect pair and the
  per-card reset, bus-enable and Vcc controls are board wiring, described
  as GPIOs and a supply. A socket with no detect line reports a
  permanently absent card, so that one is required.

properties:
  $nodename:
    pattern: "^pcmcia@[23]0000000$"

  compatible:
    const: intel,sa1110-pcmcia

  reg:
    maxItems: 1
    description: the socket's 256 MiB card window

  clocks:
    maxItems: 1
    description:
      The core clock (CCLK), which the MECR access timing counts in.

  detect-gpios:
    maxItems: 1
    description: card detect (nCD), asserted while a card is seated

  ready-gpios:
    maxItems: 1
    description: RDY/nIREQ

  bvd1-gpios:
    maxItems: 1

  bvd2-gpios:
    maxItems: 1

  reset-gpios:
    maxItems: 1
    description: the per-card RESET pin, deasserted at idle

  bus-enable-gpios:
    maxItems: 1
    description: buffer/bus enable for the socket's data path

  vcc-supply:
    description: the card's Vcc rail, switched between off and 3.3 V

required:
  - compatible
  - reg
  - clocks
  - detect-gpios
  - reset-gpios

additionalProperties: false

examples:
  - |
    #include <dt-bindings/clock/intel,sa1100-clocks.h>
    #include <dt-bindings/gpio/gpio.h>

    pcmcia@20000000 {
        compatible = "intel,sa1110-pcmcia";
        reg = <0x20000000 0x10000000>;
        clocks = <&clks SA1100_CLK_CPU>;
        detect-gpios = <&gpio 17 GPIO_ACTIVE_LOW>;
        ready-gpios = <&gpio 21 GPIO_ACTIVE_HIGH>;
        reset-gpios = <&asic2 8 GPIO_ACTIVE_HIGH>;
        vcc-supply = <&cf_vcc>;
    };
...
```

## Documentation/devicetree/bindings/pinctrl/intel,sa1100-pinctrl.yaml
```yaml
# SPDX-License-Identifier: (GPL-2.0-only OR BSD-2-Clause)
%YAML 1.2
---
$id: http://devicetree.org/schemas/pinctrl/intel,sa1100-pinctrl.yaml#
$schema: http://devicetree.org/meta-schemas/core.yaml#

title: Intel SA-1100/SA-1110 pin controller

maintainers:
  - Koen Kooi <koen@dominion.thruhere.net>

description: >-
  The SA-1100/SA-1110 SoC's pin-multiplexing block: one flat 32-bit GAFR
  register, one BOOLEAN bit per pin enabling that pin's single alternate
  peripheral function -- not a multi-bit mux-select field like PXA's
  GAFRn_x -- paired with one bit per pin in GPDR for direction. 28 pins,
  P0-P27; bits 28-31 of both registers are reserved. Most pins have exactly
  one fixed alternate function, so no per-pin multi-way function selection
  exists on this silicon.

  No PIN_CONFIG_* parameter of any kind is supported: the eight registers
  at this block's fixed offset (GPLR/GPDR/GPSR/GPCR/GRER/GFER/GEDR/GAFR)
  are all there is -- unlike PXA's equivalent block, there is no
  PGSR-style sleep-state register anywhere in it. In particular there is
  no "low-power-mode" property on this binding.

  P21 and P22's several named functions below all share one GAFR bit
  each -- which real pad function a board actually gets is selected by
  TUCR_TIC/TUCR_MR, which this controller does not touch. P27's
  "32_768kHz" function drives the pin with the internal clock that the
  TSEL field of TUCR selects, the 32.768 kHz oscillator after reset; TSEL
  itself belongs to the clock controller, not to this block.

properties:
  compatible:
    items:
      - const: intel,sa1110-pinctrl
      - const: intel,sa1100-pinctrl

  reg:
    minItems: 2
    maxItems: 2

  reg-names:
    items:
      - const: gafr
      - const: gpdr

patternProperties:
  "-pins$":
    type: object
    $ref: pinmux-node.yaml#
    additionalProperties: false

    properties:
      pins:
        description:
          One or more of the 28 pin names below.
        items:
          pattern: "^P(1?[0-9]|2[0-7])$"

      function:
        enum: [gpio_in, gpio_out, LDD, SSP_TXD, SSP_RXD, SSP_SCLK, SSP_SFRM,
               UART_TXD, UART_RXD, SDLC_SCLK, SDLC_AAF, UART_SCLK1, SSP_CLK,
               UART_SCLK3, MCP_CLK, TIC_ACK, MBGNT, TREQA, MBREQ, TREQB,
               1Hz, RCLK, 32_768kHz]

    required:
      - pins
      - function

required:
  - compatible
  - reg
  - reg-names

additionalProperties: false

examples:
  - |
    pinctrl@9004001c {
        compatible = "intel,sa1110-pinctrl", "intel,sa1100-pinctrl";
        reg = <0x9004001c 0x4>, <0x90040004 0x4>;
        reg-names = "gafr", "gpdr";

        lcd-data-pins {
            pins = "P2", "P3", "P4", "P5", "P6", "P7", "P8", "P9";
            function = "LDD";
        };
    };

...
```
