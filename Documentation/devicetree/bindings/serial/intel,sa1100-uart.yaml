## drivers/net/wireless/intersil/orinoco/Kconfig
```kconfig
# SPDX-License-Identifier: GPL-2.0-only

config HERMES
	tristate "Hermes/HFA384x chipset 802.11b support (Orinoco/Prism2/Symbol)"
	depends on PCMCIA
	depends on CFG80211
	select CRYPTO
	select CRYPTO_AES
	select CRYPTO_AEAD
	select CRYPTO_CCM
	help
	  A driver for 802.11b wireless cards based on the "Hermes" or
	  Intersil HFA384x (Prism 2) MAC controller, as used in the Lucent
	  Orinoco and Cabletron RoamAbout cards and most of their rebadges.

	  This option builds the chip transport (register/command/BAP
	  access) and the bus-independent driver core (net_device plus
	  cfg80211 wiphy, nl80211-only -- no wireless-extensions ioctls).
	  It does nothing by itself without a bus client
	  (CONFIG_PCMCIA_HERMES below).

config HERMES_PRISM
	bool "Support Prism 2/2.5 chipset"
	depends on HERMES
	default y
	help
	  Say Y to enable support for Prism 2 and 2.5 chipsets.

	  Prism firmware does no WPA crypto itself; it hands the cipher to
	  the host (the HOSTENCRYPT/HOSTDECRYPT bits of CNFWEPFLAGS), so
	  the driver does WPA2/CCMP in software. This needs station
	  firmware 1.7.0 or newer, which can put the RSN element into the
	  association request it builds.

	  If you are not sure, say Y.

config HERMES_PRISM_FWDL
	bool "Volatile (RAM-only) firmware download for Prism 2/2.5"
	depends on HERMES_PRISM
	select FW_LOADER
	help
	  Say Y to let an operator load an Intersil Prism Secondary/Station
	  firmware image into the card's RAM at runtime, replacing the
	  flash-resident firmware until the next hardware-level reset
	  (power cycle, PCMCIA card/COR reset, or a suspend/resume that
	  power-cycles the socket). The Hermes INIT command the driver
	  issues afterwards is not such a reset and does not revert the
	  download. The download is triggered only by writing "1" to
	  /sys/class/net/wlanN/prism_download, never automatically at probe
	  time.

	  The image is requested as intersil/prism_sta_fw.hex. Images with
	  PDA-plug records are personalized from the card's own PDA, which
	  must be readable and CRC-clean or the download is refused.

	  If the Station image needs a PRI interface range that the
	  card's Primary firmware does not supply (a Prism 2.5 card with
	  Primary 1.0.x and a 1.7/1.8 Station image), the driver first
	  downloads a RAM Primary requested as intersil/prism_pri_fw.hex,
	  then the Station image. With no such file it refuses before
	  touching the card.

	  This only ever writes to volatile (RAM) storage: it never
	  issues the card's non-volatile/flash programming command.

	  If unsure, say N.

config PCMCIA_HERMES
	tristate "Hermes PCMCIA card support"
	depends on HERMES && PCMCIA && HAS_IOPORT_MAP
	help
	  PCMCIA/CompactFlash client glue for "Hermes" chipset based wireless
	  adaptors, such as the Lucent WavelanIEEE/Orinoco cards and their
	  OEM (Cabletron/EnteraSys RoamAbout 802.11, ELSA Airlancer, Melco
	  Buffalo and others). It should also be usable on various Prism II
	  based cards such as the Linksys, D-Link and Farallon Skyline.
```

## sound/soc/pxa/Kconfig
```kconfig
# SPDX-License-Identifier: GPL-2.0-only
menu "PXA"

config SND_PXA2XX_SOC
	tristate "SoC Audio for the Intel PXA2xx chip"
	depends on ARCH_PXA || (COMPILE_TEST && GPIOLIB_LEGACY)
	select SND_PXA2XX_LIB
	help
	  Say Y or M if you want to add support for codecs attached to
	  the PXA2xx AC97, I2S or SSP interface. You will also need
	  to select the audio interfaces to support below.

config SND_PXA2XX_SOC_AC97
	tristate "SoC AC97 support for PXA2xx"
	depends on SND_PXA2XX_SOC
	depends on AC97_BUS=n
	default y
	select AC97_BUS_NEW
	select SND_PXA2XX_LIB
	select SND_PXA2XX_LIB_AC97

config SND_PXA2XX_SOC_I2S
	select SND_PXA2XX_LIB
	tristate

config SND_PXA_SOC_SSP
	tristate "Soc Audio via PXA2xx/PXA3xx SSP ports"
	depends on ARCH_PXA
	select PXA_SSP
	select SND_PXA2XX_LIB

config SND_MMP_SOC_SSPA
	tristate "SoC Audio via MMP SSPA ports"
	depends on ARCH_MMP
	select SND_SOC_GENERIC_DMAENGINE_PCM
	help
	  Say Y if you want to add support for codecs attached to
	  the MMP SSPA interface.

config SND_PXA2XX_SOC_SPITZ
	tristate "SoC Audio support for Sharp Zaurus SL-Cxx00"
	depends on SND_PXA2XX_SOC && PXA_SHARP_Cxx00 && I2C
	select SND_PXA2XX_SOC_I2S
	select SND_SOC_WM8750
	help
	  Say Y if you want to add support for SoC audio on Sharp
	  Zaurus SL-Cxx00 models (Spitz, Borzoi and Akita).

config SND_PXA2XX_SOC_H2200
	tristate "SoC Audio support for HP iPAQ h2200"
	depends on SND_PXA2XX_SOC && ARCH_PXA && I2C
	select SND_PXA2XX_SOC_I2S
	select SND_SOC_UDA1380
	help
	  Say Y if you want to add support for SoC audio on the HP iPAQ
	  h2200, using its onboard Philips/NXP UDA1380 codec over I2S
	  (PXA-master) and I2C. The driver also handles the speaker
	  amplifier, the microphone bias and the headphone jack detect.

	  To compile this driver as a module, choose M here: the module
	  will be called snd-soc-h2200.

config SND_PXA2XX_SOC_H3900
	tristate "SoC Audio support for HP iPAQ h3900"
	depends on SND_PXA2XX_SOC && ARCH_PXA && I2C
	select SND_PXA2XX_SOC_I2S
	select SND_SOC_UDA1380
	help
	  Say Y if you want to add support for SoC audio on the HP iPAQ
	  h3900 family (h3950/h3955/h3970/h3975), using its onboard
	  Philips/NXP UDA1380 codec over I2S (PXA-master) and I2C. The
	  driver also handles the speaker amplifier, the built-in
	  microphone route and the headphone jack detect.

	  To compile this driver as a module, choose M here: the module
	  will be called snd-soc-h3900.

config SND_PXA2XX_SOC_H5000
	tristate "SoC Audio support for HP iPAQ h5xxx"
	depends on SND_PXA2XX_SOC && ARCH_PXA && I2C
	select SND_PXA2XX_SOC_I2S
	select SND_SOC_AK4535
	help
	  Say Y if you want to add support for SoC audio on the HP iPAQ
	  h5xxx (h51xx/h54xx/h55xx), using its onboard Asahi Kasei AK4535
	  codec over I2S (PXA-master) and I2C. The driver also handles the
	  codec and output stage supplies and the headphone jack detect.

	  To compile this driver as a module, choose M here: the module
	  will be called snd-soc-h5000.

config SND_PXA910_SOC
	tristate "SoC Audio for Marvell PXA910 chip"
	depends on ARCH_MMP && SND
	select SND_PCM
	help
	  Say Y if you want to add support for SoC audio on the
	  Marvell PXA910 reference platform.

config SND_PXA2XX_LIB
	tristate
	select SND_DMAENGINE_PCM

config SND_PXA2XX_LIB_AC97
	bool
endmenu
```

## sound/soc/sa11x0/Kconfig
```kconfig
# SPDX-License-Identifier: GPL-2.0-only
menu "SA11x0"

config SND_SA11X0_SOC
	tristate "SoC Audio for the Intel/StrongARM SA-1100/SA-1110 chip"
	depends on ARCH_SA1100 || COMPILE_TEST
	help
	  Say Y or M if you want to add support for codecs attached to the
	  SA-1100/SA-1110 SSP interface. You will also need to select the
	  audio interfaces to support below. The SA-1100 and SA-1110 are
	  the StrongARM based SoCs found, for example, in the HP iPAQ h3800
	  family of handheld computers.

config SND_SA11X0_SOC_SSP
	tristate "SoC Audio via SA-1110 SSP ports"
	depends on SND_SA11X0_SOC
	select SND_SOC_GENERIC_DMAENGINE_PCM
	help
	  Say Y or M here to build the CPU DAI driver for the Ser4 SSP port of
	  the SA-1110. It transfers audio samples to the codec by DMA, in the
	  16-bit TI synchronous serial frame format. The SSP drives the bit
	  clock and the frame, dividing the bit clock from a reference clock
	  on GPIO19. Only playback is supported.

endmenu
```
