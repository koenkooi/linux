## Documentation/devicetree/bindings/gpio/htc,asic1-gpio.yaml
```yaml
# SPDX-License-Identifier: (GPL-2.0-only OR BSD-2-Clause)
%YAML 1.2
---
$id: http://devicetree.org/schemas/gpio/htc,asic1-gpio.yaml#
$schema: http://devicetree.org/meta-schemas/core.yaml#

title: HTC ASIC1 GPIO block

maintainers:
  - Koen Kooi <koen@dominion.thruhere.net>

description: >-
  ASIC1 is the SD/MMC host and power-rail companion chip of the HP/Compaq
  iPAQ h38xx family. It has no chip select of its own: the SoC reaches it
  through a sub-range of ASIC2's register window, with ASIC2 forwarding
  the bus cycles, so this node is always a child of an htc,asic2 node
  (Documentation/devicetree/bindings/mfd/htc,asic2.yaml) and carries no
  reg of its own -- the ASIC2 driver hands the block its register window.

  The block has 15 lines, every one of them wired as a power-rail or
  routing output on every known board (IR module, SD, RS232 transceiver,
  charger, the five LCD rails, frontlight, Bluetooth, speaker/headphone
  routing and audio power). The block also has an interrupt controller
  of its own, but no board routes its output to the SoC, so no
  interrupt-controller properties are described.

properties:
  compatible:
    const: htc,asic1-gpio

  gpio-controller: true

  '#gpio-cells':
    const: 2

  gpio-line-names:
    minItems: 1
    maxItems: 15

required:
  - compatible
  - gpio-controller
  - '#gpio-cells'

additionalProperties: false

examples:
  - |
    gpio {
        compatible = "htc,asic1-gpio";
        gpio-controller;
        #gpio-cells = <2>;
        gpio-line-names = "IR_ON_N", "SD_PWR_ON", "RS232_ON", "PULSE_GEN",
                          "CH_TIMER", "LCD_5V_ON", "LCD_ON", "LCD_PCI",
                          "VGH_ON", "VGL_ON", "FL_PWR_ON", "BT_PWR_ON",
                          "SPK_ON", "EAR_ON_N", "AUD_PWR_ON";
    };

...
```

## Documentation/devicetree/bindings/gpio/htc,egpio.yaml
```yaml
# SPDX-License-Identifier: (GPL-2.0-only OR BSD-2-Clause)
%YAML 1.2
---
$id: http://devicetree.org/schemas/gpio/htc,egpio.yaml#
$schema: http://devicetree.org/meta-schemas/core.yaml#

title: HTC EGPIO CPLD-based GPIO expander

maintainers:
  - Koen Kooi <koen@dominion.thruhere.net>

description: |
  EGPIO is a CPLD-implemented GPIO expander found on HTC-designed iPAQ
  handhelds (h3600, h3700, h3800 and hx4700), wired as a VLIO-mode MMIO
  device behind a static-memory chip select. It is not the ASIC3
  companion ASIC (see htc,asic3.yaml): it only provides flat banks of GPIO
  lines whose direction is fixed at boot and, optionally, one shared
  upstream interrupt line muxed across all input pins.

  One register window can back several independently addressable GPIO
  ranges. Each range is a child node and becomes its own gpio_chip, at its
  own register offset within the window.

  The chip cannot act as an interrupt controller: its interrupt demux
  works on a static range of Linux IRQ numbers and has no irq_domain.
  "interrupts" only describes the upstream trigger line.

properties:
  compatible:
    const: htc,egpio

  reg:
    maxItems: 1
    description: |
      The chip's register window, sized to cover every child range's
      highest "reg" offset plus that range's own register span.

  interrupts:
    maxItems: 1
    description: |
      The chip's single upstream interrupt line, edge-rising, shared by
      every input pin in every child range. Omit it on boards that wire
      every range as fixed outputs.

      Describes the board wiring only. A DT-probed chip has no irq_base
      and no irq_domain, so the driver logs the line and does not use it.

  htc,reg-width:
    $ref: /schemas/types.yaml#/definitions/uint32
    enum: [8, 16]
    description: |
      Number of GPIO lines packed into one register. A child range
      spans DIV_ROUND_UP(ngpios, htc,reg-width) registers starting at its
      "reg".

  htc,bus-width:
    $ref: /schemas/types.yaml#/definitions/uint32
    enum: [16, 32]
    description: |
      Alignment, in bits, of consecutive registers within the window:
      16 means adjacent registers are 2 bytes apart, 32 means 4. A 16-bit
      wide register can sit on a 32-bit stride.

  htc,ack-register:
    $ref: /schemas/types.yaml#/definitions/uint32
    description: |
      Register offset, in the same units as each child's "reg", of the
      shared IRQ ack/status register the chained interrupt handler
      reads and acks in one write. Meaningful only when "interrupts" is
      present.

  htc,invert-acks:
    type: boolean
    description: |
      Set if this chip requires writing 0, not 1, to ack a pending IRQ.

  "#address-cells":
    const: 1

  "#size-cells":
    const: 0

patternProperties:
  "^gpio-chip@[0-9a-f]+$":
    type: object
    additionalProperties: false
    description: |
      One independently addressable GPIO range within the shared
      register window. It is not probed separately; the driver bound to
      the parent node owns every range.

    properties:
      reg:
        maxItems: 1
        description: |
          Register offset of the range within the window.

      gpio-controller: true

      "#gpio-cells":
        const: 2

      ngpios:
        minimum: 1
        maximum: 32

      htc,direction:
        $ref: /schemas/types.yaml#/definitions/uint32
        description: |
          Bitfield, one bit per line, 0 = fixed input, 1 = fixed output.
          The direction cannot be switched at runtime.

      htc,initial-values:
        $ref: /schemas/types.yaml#/definitions/uint32
        description: |
          Bitfield of the value driven onto each output line before the
          first consumer uses it, and again on resume. Bits for input
          lines are ignored.

    required:
      - reg
      - gpio-controller
      - "#gpio-cells"
      - ngpios
      - htc,direction

required:
  - compatible
  - reg
  - htc,reg-width
  - htc,bus-width
  - "#address-cells"
  - "#size-cells"

additionalProperties: false

examples:
  - |
    gpio-expander@c800000 {
        compatible = "htc,egpio";
        reg = <0x0c800000 0x4>;

        interrupt-parent = <&gpio>;
        interrupts = <18 4>;

        htc,reg-width = <16>;
        htc,bus-width = <16>;
        htc,ack-register = <0>;

        #address-cells = <1>;
        #size-cells = <0>;

        gpio-chip@0 {
            reg = <0>;
            gpio-controller;
            #gpio-cells = <2>;
            ngpios = <16>;
            htc,direction = <0xffff>;
            htc,initial-values = <0x0080>;
        };
    };
```

## Documentation/devicetree/bindings/gpio/intel,sa1100-gpio.yaml
```yaml
# SPDX-License-Identifier: GPL-2.0-only OR BSD-2-Clause
%YAML 1.2
---
$id: http://devicetree.org/schemas/gpio/intel,sa1100-gpio.yaml#
$schema: http://devicetree.org/meta-schemas/core.yaml#

title: Intel SA-1100/SA-1110 GPIO controller

maintainers:
  - Koen Kooi <koen@dominion.thruhere.net>

description: >-
  The 28-line GPIO block of the SA-1100/SA-1110 (GPLR, GPDR, GPSR, GPCR,
  GRER, GFER, GEDR and GAFR registers). The interrupts are edge-only, so
  #interrupt-cells is the usual two-cell (hwirq, flags) form but no level
  trigger type is valid. The 28 lines aggregate onto twelve interrupts of
  the parent interrupt controller: GPIO0-10 individually, GPIO11-27 as one
  shared line.

properties:
  compatible:
    items:
      - const: intel,sa1110-gpio
      - const: intel,sa1100-gpio

  reg:
    maxItems: 1

  gpio-controller: true

  '#gpio-cells':
    const: 2

  interrupts:
    minItems: 12
    maxItems: 12
    description: >-
      GPIO0-10's own individual parent hwirqs, followed by the single
      shared GPIO11-27 line, in that order.

  interrupt-controller: true

  '#interrupt-cells':
    const: 2

required:
  - compatible
  - reg
  - gpio-controller
  - '#gpio-cells'
  - interrupts
  - interrupt-controller
  - '#interrupt-cells'

additionalProperties: false

examples:
  - |
    gpio@90040000 {
        compatible = "intel,sa1110-gpio", "intel,sa1100-gpio";
        reg = <0x90040000 0x20>;
        gpio-controller;
        #gpio-cells = <2>;
        interrupt-parent = <&intc>;
        interrupts = <0>, <1>, <2>, <3>, <4>, <5>, <6>, <7>, <8>, <9>,
                     <10>, <11>;
        interrupt-controller;
        #interrupt-cells = <2>;
    };

...
```

## Documentation/devicetree/bindings/gpio/intel,sa1100-ppc.yaml
```yaml
# SPDX-License-Identifier: GPL-2.0-only OR BSD-2-Clause
%YAML 1.2
---
$id: http://devicetree.org/schemas/gpio/intel,sa1100-ppc.yaml#
$schema: http://devicetree.org/meta-schemas/core.yaml#

title: Intel SA-1110 Peripheral Pin Controller (PPC) GPIO

maintainers:
  - Koen Kooi <koen@dominion.thruhere.net>

description: >-
  The SA-1110 PPC block lets a handful of SoC pins normally
  driven by their own on-chip peripheral (the LCD controller, Ser1-Ser4)
  be used as plain GPIO instead, via a per-pin direction (PPDR), state
  (PPSR), assignment (PPAR), sleep direction (PSDR) and flag (PPFR)
  register set. A line becomes a GPIO when a consumer refers to it; a
  line that no node refers to stays with its peripheral, so a board that
  uses Ser1 as a UART describes nothing here. The reg property must
  cover only these five registers (0x14 bytes): two unrelated registers,
  HSCR2 and MCCR1, live immediately past them in the same page and must
  never be claimed by this node.

properties:
  compatible:
    const: intel,sa1110-ppc

  reg:
    maxItems: 1
    description: PPDR..PPFR only -- 0x14 bytes, never more.

  gpio-controller: true

  '#gpio-cells':
    const: 2

  gpio-line-names:
    minItems: 1
    maxItems: 22

required:
  - compatible
  - reg
  - gpio-controller
  - '#gpio-cells'

additionalProperties: false

examples:
  - |
    gpio@90060000 {
        compatible = "intel,sa1110-ppc";
        reg = <0x90060000 0x14>;
        gpio-controller;
        #gpio-cells = <2>;
        gpio-line-names = "", "", "", "", "", "", "", "", "", "", "", "",
                          "COM_DTR", "NSD_WP";
    };

...
```

## Documentation/devicetree/bindings/input/gpio-combo-keys.yaml
```yaml
# SPDX-License-Identifier: (GPL-2.0-only OR BSD-2-Clause)
%YAML 1.2
---
$id: http://devicetree.org/schemas/input/gpio-combo-keys.yaml#
$schema: http://devicetree.org/meta-schemas/core.yaml#

title: GPIO combination keys

maintainers:
  - Koen Kooi <koen@dominion.thruhere.net>

description: |
  A set of switch contacts, each on its own GPIO line, where a key is
  identified by the combination of lines that are active rather than by a
  single line. A typical example is a rocker or 5-way navigation pad whose
  contacts sit between the directions, so that one direction closes two
  contacts and a centre contact closes with every press.

  Each child node describes one combination. A combination matches when every
  line listed in its active-lines is active and every other line in line-gpios
  is inactive. No two children may describe the same combination.

  The contacts of one press close and open at slightly different times, so the
  device reports a combination only after all lines have been unchanged for
  debounce-delay-ms. Intermediate combinations seen while a press or release
  is still settling are not reported. Releases are settled the same way.

allOf:
  - $ref: input.yaml#

properties:
  compatible:
    const: gpio-combo-keys

  line-gpios:
    description:
      The GPIO lines making up the combinations, in the order the children
      index them. The active level of each line is given by its GPIO flags.
    minItems: 2
    maxItems: 32

  debounce-delay-ms:
    description:
      Time all lines must stay unchanged before the current combination is
      reported. It applies to presses and releases alike and restarts on every
      line change. When absent, 50 milliseconds are used.

  autorepeat: true

  label:
    description: Name of the input device.

  wakeup-source: true

patternProperties:
  "^key-[a-z0-9-]+$":
    type: object
    additionalProperties: false

    properties:
      label:
        description: Descriptive name of the key.

      active-lines:
        description:
          Indices into line-gpios of the lines that are active for this
          combination. All other lines must be inactive.
        $ref: /schemas/types.yaml#/definitions/uint32-array
        minItems: 1
        maxItems: 32
        items:
          maximum: 31

      linux,code:
        description: Key code reported when the combination matches.
        $ref: /schemas/types.yaml#/definitions/uint32

      linux,keycodes:
        description:
          Key codes reported together, as one simultaneous press, when the
          combination matches.
        $ref: /schemas/types.yaml#/definitions/uint32-array
        minItems: 1
        maxItems: 4

    required:
      - active-lines

    oneOf:
      - required: [ "linux,code" ]
      - required: [ "linux,keycodes" ]

required:
  - compatible
  - line-gpios

unevaluatedProperties: false

examples:
  - |
    #include <dt-bindings/gpio/gpio.h>
    #include <dt-bindings/input/input.h>

    /*
     * 5-way pad with its four direction contacts on the diagonals: line 0
     * closes for up-left, 1 for down-right, 2 for down-left, 3 for up-right,
     * and line 4 (centre) closes with every press.
     */
    keypad {
        compatible = "gpio-combo-keys";
        label = "Navigation pad";
        line-gpios = <&gpio 5 GPIO_ACTIVE_LOW>,
                     <&gpio 6 GPIO_ACTIVE_LOW>,
                     <&gpio 8 GPIO_ACTIVE_LOW>,
                     <&gpio 9 GPIO_ACTIVE_LOW>,
                     <&gpio 10 GPIO_ACTIVE_LOW>;
        debounce-delay-ms = <50>;

        key-select {
            label = "Select";
            active-lines = <4>;
            linux,code = <KEY_ENTER>;
        };

        key-up {
            label = "Up";
            active-lines = <0 3 4>;
            linux,code = <KEY_UP>;
        };

        key-down {
            label = "Down";
            active-lines = <1 2 4>;
            linux,code = <KEY_DOWN>;
        };

        key-right {
            label = "Right";
            active-lines = <1 3 4>;
            linux,code = <KEY_RIGHT>;
        };

        key-left {
            label = "Left";
            active-lines = <0 2 4>;
            linux,code = <KEY_LEFT>;
        };

        key-up-left {
            label = "Up-left";
            active-lines = <0 4>;
            linux,keycodes = <KEY_LEFT KEY_UP>;
        };

        key-down-left {
            label = "Down-left";
            active-lines = <2 4>;
            linux,keycodes = <KEY_LEFT KEY_DOWN>;
        };

        key-up-right {
            label = "Up-right";
            active-lines = <3 4>;
            linux,keycodes = <KEY_UP KEY_RIGHT>;
        };

        key-down-right {
            label = "Down-right";
            active-lines = <1 4>;
            linux,keycodes = <KEY_RIGHT KEY_DOWN>;
        };

        key-all {
            label = "All contacts";
            active-lines = <0 1 2 3 4>;
            linux,code = <KEY_5>;
        };
    };
...
```
