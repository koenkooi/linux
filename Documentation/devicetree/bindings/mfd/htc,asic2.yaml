## Documentation/devicetree/bindings/mmc/htc,asic3-sd.yaml
```yaml
# SPDX-License-Identifier: (GPL-2.0-only OR BSD-2-Clause)
%YAML 1.2
---
$id: http://devicetree.org/schemas/mmc/htc,asic3-sd.yaml#
$schema: http://devicetree.org/meta-schemas/core.yaml#

title: SD/MMC host cell of the Compaq/HTC ASIC3 companion ASIC

maintainers:
  - Koen Kooi <koen@dominion.thruhere.net>

description:
  The SD/MMC host is part of the ASIC3 MFD device, see
  Documentation/devicetree/bindings/mfd/htc,asic3.yaml, and is represented
  as a sub-node of the ASIC3 node.

  The host is a TMIO-style controller that is instantiated by the MFD
  driver with its registers and interrupt taken from the parent, so this
  node carries no "reg" or "interrupts" of its own. It exists to give the
  host a firmware node, from which the generic MMC properties such as
  "cd-gpios" are parsed. That matters on boards where the card-detect bits
  of the controller itself cannot be used and a GPIO of another chip has to
  report card presence.

allOf:
  - $ref: /schemas/mmc/mmc-controller.yaml#

properties:
  compatible:
    const: htc,asic3-sd

required:
  - compatible

unevaluatedProperties: false

examples:
  - |
    #include <dt-bindings/gpio/gpio.h>

    companion-chip {
        mmc {
            compatible = "htc,asic3-sd";
            cd-gpios = <&asic2 6 GPIO_ACTIVE_LOW>;
        };
    };
```

## Documentation/devicetree/bindings/mmc/marvell,pxa-mmc.yaml
```yaml
# SPDX-License-Identifier: (GPL-2.0-only OR BSD-2-Clause)
%YAML 1.2
---
$id: http://devicetree.org/schemas/mmc/marvell,pxa-mmc.yaml#
$schema: http://devicetree.org/meta-schemas/core.yaml#

title: Marvell PXA MMC/SD/SDIO controller

maintainers:
  - Koen Kooi <koen@dominion.thruhere.net>

description:
  MultiMediaCard, SD and SDIO host controller integrated into the Marvell
  (formerly Intel) PXA25x, PXA27x and PXA3xx application processors. The
  PXA25x controller only implements a one-bit data bus, the PXA27x and
  PXA3xx controllers add four-bit transfers and SDIO interrupts. The PXA3xx
  processors provide up to three instances. Data is moved by the
  peripheral DMA controller, using one receive and one transmit request
  line per instance.

allOf:
  - $ref: mmc-controller.yaml#

properties:
  compatible:
    const: marvell,pxa-mmc

  reg:
    maxItems: 1

  interrupts:
    maxItems: 1

  clocks:
    maxItems: 1

  dmas:
    maxItems: 2

  dma-names:
    items:
      - const: rx
      - const: tx

  pxa-mmc,detect-delay-ms:
    description:
      Delay between a card detect event and the rescan of the slot for a
      card. It applies only to the card detect interrupt that platform data
      registers; a card detect GPIO described with cd-gpios has its own
      debounce.
    deprecated: true
    default: 0

required:
  - compatible
  - reg
  - interrupts
  - clocks
  - dmas
  - dma-names

unevaluatedProperties: false

examples:
  - |
    #include <dt-bindings/clock/pxa-clock.h>

    mmc@41100000 {
        compatible = "marvell,pxa-mmc";
        reg = <0x41100000 0x1000>;
        interrupts = <23>;
        clocks = <&clks CLK_MMC1>;
        dmas = <&pdma 21 3>,
               <&pdma 22 3>;
        dma-names = "rx", "tx";
        vmmc-supply = <&reg_vcc_sdio>;
        mmc-pwrseq = <&mmc0_pwrseq>;
        non-removable;
        bus-width = <4>;
    };
```

## Documentation/devicetree/bindings/mmc/samsung,hamcop-sdi.yaml
```yaml
# SPDX-License-Identifier: (GPL-2.0-only OR BSD-2-Clause)
%YAML 1.2
---
$id: http://devicetree.org/schemas/mmc/samsung,hamcop-sdi.yaml#
$schema: http://devicetree.org/meta-schemas/core.yaml#

title: Samsung HAMCOP SD/MMC host

maintainers:
  - Koen Kooi <koen@dominion.thruhere.net>

description:
  SD/MMC host cell of the Samsung HAMCOP companion ASIC. It is a child node
  of the HAMCOP node and has no register window or interrupt of its own; both
  come from the parent. The card-detect line is not a HAMCOP register but a
  GPIO of the SoC the board wires to the slot.

allOf:
  - $ref: /schemas/mmc/mmc-controller.yaml#

properties:
  compatible:
    const: samsung,hamcop-sdi

required:
  - compatible

unevaluatedProperties: false

examples:
  - |
    #include <dt-bindings/gpio/gpio.h>

    companion-chip {
        mmc {
            compatible = "samsung,hamcop-sdi";
            cd-gpios = <&gpio 8 GPIO_ACTIVE_LOW>;
        };
    };
```

## Documentation/devicetree/bindings/mmc/samsung,samcop-sdi.yaml
```yaml
# SPDX-License-Identifier: (GPL-2.0-only OR BSD-2-Clause)
%YAML 1.2
---
$id: http://devicetree.org/schemas/mmc/samsung,samcop-sdi.yaml#
$schema: http://devicetree.org/meta-schemas/core.yaml#

title: Samsung SAMCOP SD/MMC host

maintainers:
  - Koen Kooi <koen@dominion.thruhere.net>

description: >-
  The SD/MMC host (SDI) block of the Samsung SAMCOP companion ASIC
  (Documentation/devicetree/bindings/mfd/samsung,samcop.yaml). It is a
  4-bit host with a single card slot. The block has no register
  window or interrupt properties of its own: the parent hands it its
  register sub-range, its completion interrupt and its card-detect wakeup
  interrupt, and its clock gate is internal to the parent.

  Of the common MMC host properties the driver uses only cd-gpios,
  wp-gpios and vmmc-supply; the host always runs with four data lines.

  Card detect, write protect and slot power are board wiring. Card detect
  is a level read from a GPIO, and the parent's card-detect wakeup
  interrupt reports its edges; write protect is a plain GPIO; slot power is
  a supply regulator.

allOf:
  - $ref: /schemas/mmc/mmc-controller.yaml#

properties:
  compatible:
    const: samsung,samcop-sdi

required:
  - compatible

unevaluatedProperties: false

examples:
  - |
    #include <dt-bindings/gpio/gpio.h>

    companion-chip {
        mmc {
            compatible = "samsung,samcop-sdi";
            cd-gpios = <&samcop 16 GPIO_ACTIVE_LOW>;
            wp-gpios = <&gpio 74 GPIO_ACTIVE_HIGH>;
            vmmc-supply = <&sd_vmmc>;
        };
    };
```

## Documentation/devicetree/bindings/net/bluetooth/hp,ipaq-h2200-bt.yaml
```yaml
# SPDX-License-Identifier: (GPL-2.0-only OR BSD-2-Clause)
%YAML 1.2
---
$id: http://devicetree.org/schemas/net/bluetooth/hp,ipaq-h2200-bt.yaml#
$schema: http://devicetree.org/meta-schemas/core.yaml#

title: HP iPAQ h2200 Bluetooth module power control

maintainers:
  - Koen Kooi <koen@dominion.thruhere.net>

description: >-
  The HP iPAQ h2200 carries a Zeevo Bluetooth module whose HCI transport
  is a plain H4 UART driven from userspace. This node describes only the
  board's power, reset and wake lines to the module and the strap that
  identifies which module is fitted; the host exposes them as a Bluetooth
  rfkill switch whose unblock runs the module's power-on sequence.

properties:
  compatible:
    const: hp,ipaq-h2200-bt

  reset-gpios:
    maxItems: 1
    description: The module's active-low reset input.

  power-gpios:
    maxItems: 1
    description: Switches the module's power on when asserted.

  device-wakeup-gpios:
    maxItems: 1
    description: Host-to-module wakeup signal.

  ident-gpios:
    maxItems: 1
    description:
      Module identification strap, asserted when the Zeevo module is
      fitted.

required:
  - compatible
  - reset-gpios
  - power-gpios
  - device-wakeup-gpios
  - ident-gpios

additionalProperties: false

examples:
  - |
    #include <dt-bindings/gpio/gpio.h>

    bluetooth {
        compatible = "hp,ipaq-h2200-bt";
        reset-gpios = <&gpio 74 GPIO_ACTIVE_LOW>;
        power-gpios = <&gpio 76 GPIO_ACTIVE_HIGH>;
        device-wakeup-gpios = <&gpio 10 GPIO_ACTIVE_HIGH>;
        ident-gpios = <&gpio 75 GPIO_ACTIVE_HIGH>;
    };

...
```

## Documentation/devicetree/bindings/net/bluetooth/hp,ipaq-h5000-bt.yaml
```yaml
# SPDX-License-Identifier: (GPL-2.0-only OR BSD-2-Clause)
%YAML 1.2
---
$id: http://devicetree.org/schemas/net/bluetooth/hp,ipaq-h5000-bt.yaml#
$schema: http://devicetree.org/meta-schemas/core.yaml#

title: HP iPAQ h5000 Bluetooth module power control

maintainers:
  - Koen Kooi <koen@dominion.thruhere.net>

description: >-
  The HP iPAQ h51xx/h54xx/h55xx carries a National Semiconductor LMX9814
  Bluetooth module whose HCI transport is a plain H4 UART driven from
  userspace. This node describes only the board's reset, operating
  environment strap and supply lines to the module; the host exposes them
  as a Bluetooth rfkill switch whose unblock runs the module's power-on
  sequence.

properties:
  compatible:
    const: hp,ipaq-h5000-bt

  reset-gpios:
    maxItems: 1
    description: The module's active-low reset input.

  env0-gpios:
    maxItems: 1
    description:
      Operating environment select 0. Driven high with env1 to run the
      module normally; with env0 low and env1 high it enters in-system
      programming mode.

  env1-gpios:
    maxItems: 1
    description: Operating environment select 1, see env0-gpios.

  power-3v0-gpios:
    maxItems: 1
    description: Enable of the module's 3.0 V supply, active high.

  power-2v8-gpios:
    maxItems: 1
    description: Enable of the module's 2.8 V supply, active high.

required:
  - compatible
  - reset-gpios
  - env0-gpios
  - env1-gpios
  - power-3v0-gpios
  - power-2v8-gpios

additionalProperties: false

examples:
  - |
    #include <dt-bindings/gpio/gpio.h>

    bluetooth {
        compatible = "hp,ipaq-h5000-bt";
        reset-gpios = <&gpio 72 GPIO_ACTIVE_LOW>;
        env0-gpios = <&gpio 11 GPIO_ACTIVE_HIGH>;
        env1-gpios = <&gpio 13 GPIO_ACTIVE_HIGH>;
        power-3v0-gpios = <&samcop 37 GPIO_ACTIVE_HIGH>;
        power-2v8-gpios = <&gpio 67 GPIO_ACTIVE_HIGH>;
    };

...
```

## Documentation/devicetree/bindings/net/bluetooth/hp,ipaq-hx4700-bt.yaml
```yaml
# SPDX-License-Identifier: (GPL-2.0-only OR BSD-2-Clause)
%YAML 1.2
---
$id: http://devicetree.org/schemas/net/bluetooth/hp,ipaq-hx4700-bt.yaml#
$schema: http://devicetree.org/meta-schemas/core.yaml#

title: HP iPAQ hx4700 Bluetooth module power control

maintainers:
  - Koen Kooi <koen@dominion.thruhere.net>

description: >-
  The HP iPAQ hx4700 carries a Texas Instruments BRF6150 Bluetooth module
  on the BTUART. This node describes only the board's reset and supply
  lines to the module; the host exposes them as a Bluetooth rfkill switch
  whose unblock runs the module's power-on sequence.

properties:
  compatible:
    const: hp,ipaq-hx4700-bt

  reset-gpios:
    maxItems: 1
    description: The module's active-low reset input.

  power-gpios:
    maxItems: 1
    description: Enable of the module's 3.3 V supply, active high.

required:
  - compatible
  - reset-gpios
  - power-gpios

additionalProperties: false

examples:
  - |
    #include <dt-bindings/gpio/gpio.h>

    bluetooth {
        compatible = "hp,ipaq-hx4700-bt";
        reset-gpios = <&gpio 106 GPIO_ACTIVE_LOW>;
        power-gpios = <&egpio0 5 GPIO_ACTIVE_HIGH>;
    };

...
```

## Documentation/devicetree/bindings/net/hp,ipaq-h5000-wlan.yaml
```yaml
# SPDX-License-Identifier: (GPL-2.0-only OR BSD-2-Clause)
%YAML 1.2
---
$id: http://devicetree.org/schemas/net/hp,ipaq-h5000-wlan.yaml#
$schema: http://devicetree.org/meta-schemas/core.yaml#

title: HP iPAQ h5000 onboard WLAN power sequencer

maintainers:
  - Koen Kooi <koen@dominion.thruhere.net>

description:
  Power sequencing for the onboard AT76C503A WLAN radio of the HP iPAQ
  h51xx/h54xx/h55xx. The radio is attached by USB, behind the root hub of
  the SAMCOP OHCI controller (the "ohci" child of samsung,samcop.yaml),
  and has no devicetree node of its own because it enumerates dynamically.
  This node only sequences the two SAMCOP GPB outputs that power the radio
  before it can enumerate. The host exposes them as a WLAN rfkill switch,
  so the radio can be blocked and unblocked, or powered down for suspend,
  independently of the USB host controller.

properties:
  compatible:
    const: hp,ipaq-h5000-wlan

  rf-power-gpios:
    maxItems: 1
    description: Enable for the radio's RF section, SAMCOP GPB1.

  wlan-power-gpios:
    maxItems: 1
    description:
      Enable for the radio's digital section, SAMCOP GPB3. It is raised
      together with rf-power-gpios. It is not known whether the radio needs
      both.

required:
  - compatible
  - rf-power-gpios
  - wlan-power-gpios

additionalProperties: false

examples:
  - |
    #include <dt-bindings/gpio/gpio.h>

    wlan {
        compatible = "hp,ipaq-h5000-wlan";
        rf-power-gpios = <&samcop 33 GPIO_ACTIVE_HIGH>;
        wlan-power-gpios = <&samcop 35 GPIO_ACTIVE_HIGH>;
    };
```

## Documentation/devicetree/bindings/pcmcia/hp,ipaq-h2200-pcmcia.yaml
```yaml
# SPDX-License-Identifier: (GPL-2.0-only OR BSD-2-Clause)
%YAML 1.2
---
$id: http://devicetree.org/schemas/pcmcia/hp,ipaq-h2200-pcmcia.yaml#
$schema: http://devicetree.org/meta-schemas/core.yaml#

title: HP iPAQ h2200 CompactFlash socket

maintainers:
  - Koen Kooi <koen@dominion.thruhere.net>

description: |
  The single CompactFlash socket of the HP iPAQ h2200, wired to the first
  of the PXA25x's PC Card sockets. The card's address and data signals
  ride the SoC's own PC Card interface, whose pins the board muxes, so the
  node has no register window or interrupt of its own. It describes only
  the board wiring around that interface, all of it plain SoC GPIO lines.

  Card detect and the card's ready/interrupt request line are inputs. The
  card's reset and three enables, gating the socket's Vcc supply and its
  address and data buffers, are outputs.

properties:
  $nodename:
    const: pcmcia

  compatible:
    const: hp,ipaq-h2200-pcmcia

  detect-gpios:
    maxItems: 1
    description:
      Card detect (CF_DETECT_N), low while a card is seated. Must be usable
      as an interrupt source so that insertion and removal are noticed.

  ready-gpios:
    maxItems: 1
    description:
      The card's ready/busy indication for memory cards and interrupt
      request for I/O cards (CF_INT_N). Must be usable as an interrupt
      source.

  reset-gpios:
    maxItems: 1
    description:
      The card's RESET pin (CF_RESET).

  power-gpios:
    maxItems: 1
    description:
      Enable for the socket's Vcc supply (CF_POWER_EN).

  add-en-gpios:
    maxItems: 1
    description:
      Enable for the buffers between the SoC address lines and the socket
      (CF_ADD_EN_N), an active-low pin.

  buff-en-gpios:
    maxItems: 1
    description:
      Enable for the buffers between the SoC data lines and the socket
      (CF_BUFF_EN).

required:
  - compatible
  - detect-gpios
  - ready-gpios
  - reset-gpios
  - power-gpios
  - add-en-gpios
  - buff-en-gpios

additionalProperties: false

examples:
  - |
    #include <dt-bindings/gpio/gpio.h>

    pcmcia {
        compatible = "hp,ipaq-h2200-pcmcia";

        detect-gpios = <&gpio 9 GPIO_ACTIVE_LOW>;
        ready-gpios = <&gpio 7 GPIO_ACTIVE_HIGH>;
        reset-gpios = <&gpio 23 GPIO_ACTIVE_HIGH>;
        power-gpios = <&gpio 26 GPIO_ACTIVE_HIGH>;
        add-en-gpios = <&gpio 25 GPIO_ACTIVE_LOW>;
        buff-en-gpios = <&gpio 63 GPIO_ACTIVE_HIGH>;
    };
...
```
