## Documentation/devicetree/bindings/display/marvell,pxa2xx-lcdc.yaml
```yaml
# SPDX-License-Identifier: (GPL-2.0-only OR BSD-2-Clause)
%YAML 1.2
---
$id: http://devicetree.org/schemas/display/marvell,pxa2xx-lcdc.yaml#
$schema: http://devicetree.org/meta-schemas/core.yaml#

title: Marvell PXA2xx and PXA3xx LCD controller

maintainers:
  - Koen Kooi <koen@dominion.thruhere.net>

description: |
  The LCD controller integrated in the Marvell (formerly Intel) PXA25x, PXA27x
  and PXA3xx application processors. It reads the frame buffer from system
  memory through its own frame descriptor DMA engine and drives a parallel
  panel over the LCD_LDD data lines: a passive monochrome or colour STN panel,
  a dual-scan DSTN panel, an active colour TFT panel or a smart panel.

  The panel, or a bridge in front of it, is reached through a single "port"
  node using the OF graph. When the panel is not a colour TFT one, the panel
  node at the remote end of the endpoint states its type with an "lcd-type"
  string property, one of "unknown", "mono-stn", "mono-dstn", "color-stn",
  "color-dstn", "color-tft" or "smart-panel". Without the property a colour
  TFT panel is assumed. A panel node that has no driver of its own must have
  a display-timings child. It may be a sibling of the controller node or a
  child of it: it is found through the graph, so its position does not
  matter.

properties:
  $nodename:
    pattern: "^lcd-controller@[0-9a-f]+$"

  compatible:
    enum:
      - marvell,pxa2xx-lcdc
      - marvell,pxa270-lcdc
      - marvell,pxa300-lcdc

  reg:
    maxItems: 1

  interrupts:
    maxItems: 1
    description:
      LCD controller interrupt, raised for the frame start and end, FIFO
      underrun, bus error and disable-done conditions.

  clocks:
    maxItems: 1
    description:
      LCD unit clock, from which the pixel clock divider derives the pixel
      clock.

  lcd-supply:
    description:
      Regulator powering the LCD panel.

  memory-region:
    maxItems: 1
    description:
      Reserved memory the frame buffers are allocated from. The controller
      scans out of physically contiguous memory.

  port:
    $ref: /schemas/graph.yaml#/$defs/port-base
    unevaluatedProperties: false
    description:
      Connection to the panel or bridge.

    properties:
      endpoint:
        $ref: /schemas/media/video-interfaces.yaml#
        unevaluatedProperties: false

        properties:
          bus-width:
            enum: [4, 8, 16]
            description:
              Number of LCD_LDD data lines that carry pixel data. It is also
              the number of bits per pixel of the framebuffer, so only the
              depths the controller supports as a plain pixel size are
              accepted.

        required:
          - remote-endpoint
          - bus-width

    required:
      - endpoint

patternProperties:
  "^panel(@[0-9a-f]+)?$":
    type: object
    additionalProperties: true
    description:
      The panel, when its node is placed inside the controller node.

required:
  - compatible
  - reg
  - interrupts
  - clocks
  - port

additionalProperties: false

examples:
  - |
    #include <dt-bindings/clock/pxa-clock.h>

    lcd-controller@44000000 {
        compatible = "marvell,pxa2xx-lcdc";
        reg = <0x44000000 0x10000>;
        interrupts = <17>;
        clocks = <&clks CLK_LCD>;
        pinctrl-names = "default";
        pinctrl-0 = <&lcdc_pins>;
        lcd-supply = <&lcd_supply>;

        port {
            lcdc_out: endpoint {
                remote-endpoint = <&panel_in>;
                bus-width = <16>;
            };
        };
    };
```

## Documentation/devicetree/bindings/display/mediaq,mq1132.yaml
```yaml
# SPDX-License-Identifier: (GPL-2.0-only OR BSD-2-Clause)
%YAML 1.2
---
$id: http://devicetree.org/schemas/display/mediaq,mq1132.yaml#
$schema: http://devicetree.org/meta-schemas/core.yaml#

title: MediaQ MQ11xx display controllers

maintainers:
  - Koen Kooi <koen@dominion.thruhere.net>

description:
  The MediaQ MQ1132 and MQ1178/MQ1188 are external display controllers
  used on several early-2000s PDAs (HP iPAQ h2200, h5xxx). The chip sits
  on a static-memory chip select as a plain memory-mapped 16-bit device,
  scans out of its own on-chip video memory and drives a fixed TFT panel's
  parallel RGB interface directly; the host SoC's LCD controller is not
  involved. Each part has so far only been found wired to one panel
  design, so the compatible also selects that panel's timing and
  flat-panel interface setup. The MQ1188 is register-compatible with the
  MQ1178 and uses its compatible.

properties:
  compatible:
    enum:
      - mediaq,mq1132
      - mediaq,mq1178

  reg:
    items:
      - description: The on-chip video memory window (256 KiB).
      - description:
          The register window (8 KiB), immediately after the video memory
          window.

  interrupts:
    maxItems: 1
    description:
      The chip's interrupt output, an active-low level. Its sources include
      the end of each frame, the falling edge of vertical display enable. A
      board that leaves the output unconnected omits the property.

  power-supply:
    description:
      The chip's main power supply. The driver enables it after vdd-supply
      and releases reset once it is up, so the supply's own startup delay
      must cover the time the chip needs before it can leave reset.

  vdd-supply:
    description:
      The chip's core supply, switched separately from power-supply on some
      boards. Enabled first, before power-supply.

  panel-supply:
    description:
      The attached panel's own supply, separate from the chip's. Enabled
      before the chip drives the panel interface and disabled before it
      stops, whenever the display is unblanked or blanked.

  reset-gpios:
    maxItems: 1
    description: The chip's own active-low reset line.

  backlight:
    $ref: /schemas/types.yaml#/definitions/phandle
    description:
      The backlight that illuminates the attached panel, switched off
      whenever the display is blanked.

  "#pwm-cells":
    const: 3
    description:
      The chip has two internal PWM generators, PWM0 and PWM1, with an output
      pin each. A board can wire one to the panel's backlight, whose "pwms"
      then points back at this node. The cells are the generator (0 or 1), the
      period in nanoseconds and the flags.

required:
  - compatible
  - reg
  - power-supply

additionalProperties: false

examples:
  - |
    #include <dt-bindings/gpio/gpio.h>
    #include <dt-bindings/interrupt-controller/irq.h>

    display@4000000 {
        compatible = "mediaq,mq1178";
        reg = <0x04000000 0x40000>, <0x04040000 0x2000>;
        interrupt-parent = <&gpio>;
        interrupts = <14 IRQ_TYPE_LEVEL_LOW>;
        vdd-supply = <&mq_vdd>;
        power-supply = <&mq_power>;
        reset-gpios = <&gpio 68 GPIO_ACTIVE_LOW>;
        backlight = <&backlight>;
    };

  - |
    #include <dt-bindings/gpio/gpio.h>

    mediaq: display@4000000 {
        compatible = "mediaq,mq1132";
        reg = <0x04000000 0x40000>, <0x04040000 0x2000>;
        power-supply = <&mq_power>;
        panel-supply = <&lcd_power>;
        backlight = <&backlight>;
        #pwm-cells = <3>;
    };

    backlight: backlight {
        compatible = "pwm-backlight";
        pwms = <&mediaq 0 1000000 0>;
        enable-gpios = <&gpio 38 GPIO_ACTIVE_HIGH>;
        brightness-levels = <0 120 250 500 1000>;
        default-brightness-level = <4>;
    };
```

## Documentation/devicetree/bindings/display/panel/hp,ipaq-h3800-panel.yaml
```yaml
# SPDX-License-Identifier: GPL-2.0-only OR BSD-2-Clause
%YAML 1.2
---
$id: http://devicetree.org/schemas/display/panel/hp,ipaq-h3800-panel.yaml#
$schema: http://devicetree.org/meta-schemas/core.yaml#

title: HP iPAQ h38xx 320x240 TFT panel

maintainers:
  - Koen Kooi <koen@dominion.thruhere.net>

description: |
  The 320x240 16bpp reflective TFT fitted to the HP iPAQ h38xx series,
  driven over the SA-1110 application processor's parallel RGB (DPI)
  output. The part number of the glass is not known, so the compatible
  names the machine the panel is fitted to rather than the panel's
  manufacturer and part.

  The panel is powered by five separately gated supply rails plus the
  frontlight power rail, brought up and taken down in a fixed order with a
  delay after each step. The power-up order is lcd-on, vgl, vgh, lcd-5v,
  then, once the controller scans out, lcd-pci and fl-pwr. The power-down
  order is fl-pwr, lcd-pci, lcd-5v, vgl, vgh and lcd-on.

  The rails are described as GPIOs rather than as regulator supplies: they
  are raw outputs of a companion chip with no consumer other than this
  panel, including the frontlight rail (see fl-pwr-gpios), and the panel
  owns their order. A regulator-fixed node drives its enable line to a
  fixed level when the regulator probes, so rails that the boot loader
  left on would be dropped one at a time in probe order rather than in
  the panel's power-down order, and the delays between the steps belong
  to the panel's sequence, not to any one rail.

allOf:
  - $ref: panel-common.yaml#

properties:
  compatible:
    const: hp,ipaq-h3800-panel

  lcd-on-gpios:
    maxItems: 1
    description:
      Master panel enable, active high. First on, last off.

  lcd-pci-gpios:
    maxItems: 1
    description:
      Panel control input enable, active high. Fifth on (after the
      controller has started and one frame has elapsed), second off.

  lcd-5v-gpios:
    maxItems: 1
    description:
      +5 V supply enable, active high. Fourth on, third off.

  vgh-gpios:
    maxItems: 1
    description:
      Positive high (gate-on) supply enable, active high. Third on,
      fifth off.

  vgl-gpios:
    maxItems: 1
    description:
      Negative high (gate-off) supply enable, active high. Second on,
      fourth off.

  fl-pwr-gpios:
    maxItems: 1
    description:
      Frontlight power enable, active high. Sixth on, first off. Driven by
      the panel rather than by the enable-gpios of a "backlight" node, so
      that the pin keeps exactly one owner.

  port: true

required:
  - compatible
  - lcd-on-gpios
  - lcd-pci-gpios
  - lcd-5v-gpios
  - vgh-gpios
  - vgl-gpios
  - fl-pwr-gpios
  - port

unevaluatedProperties: false

examples:
  - |
    #include <dt-bindings/gpio/gpio.h>

    panel {
        compatible = "hp,ipaq-h3800-panel";

        lcd-5v-gpios  = <&asic1 5 GPIO_ACTIVE_HIGH>;
        lcd-on-gpios  = <&asic1 6 GPIO_ACTIVE_HIGH>;
        lcd-pci-gpios = <&asic1 7 GPIO_ACTIVE_HIGH>;
        vgh-gpios     = <&asic1 8 GPIO_ACTIVE_HIGH>;
        vgl-gpios     = <&asic1 9 GPIO_ACTIVE_HIGH>;
        fl-pwr-gpios  = <&asic1 10 GPIO_ACTIVE_HIGH>;

        rotation = <90>;
        backlight = <&backlight>;

        port {
            panel_in: endpoint {
                remote-endpoint = <&lcdc_out>;
            };
        };
    };
```

## Documentation/devicetree/bindings/display/panel/hp,ipaq-h3900-panel.yaml
```yaml
# SPDX-License-Identifier: (GPL-2.0-only OR BSD-2-Clause)
%YAML 1.2
---
$id: http://devicetree.org/schemas/display/panel/hp,ipaq-h3900-panel.yaml#
$schema: http://devicetree.org/meta-schemas/core.yaml#

title: HP iPAQ h3900 320x240 TFT panel

maintainers:
  - Koen Kooi <koen@dominion.thruhere.net>

description: |
  The 320x240 16bpp reflective TFT fitted to the HP iPAQ h3900 series,
  driven over the PXA25x application processor's parallel RGB (DPI)
  output. The part number of the glass is not recorded in any surviving
  documentation for the machine, so the compatible names the machine the
  panel is fitted to rather than the panel's manufacturer and part.

  The panel is powered by five separately gated supply rails, brought up
  and taken down in a fixed order with a delay after each step. The
  power-down order is not the power-up order reversed: the panel control
  input drops first rather than last, and the positive and negative high
  rails drop together in a single step.

  The rails are described as GPIOs rather than as regulator supplies
  because on this machine they are raw outputs of a companion chip with
  no regulator provider behind them and no consumer other than this
  panel, so wrapping each one in a regulator-fixed node would add five
  device tree nodes and a subsystem without describing anything the
  panel driver does not already have to sequence itself. They cannot be
  folded into panel-common.yaml's single enable-gpios, which describes
  one enable signal.

allOf:
  - $ref: panel-common.yaml#

properties:
  compatible:
    const: hp,ipaq-h3900-panel

  lcd-on-gpios:
    maxItems: 1
    description:
      Master panel enable, active high. First on, last off.

  lcd-pci-gpios:
    maxItems: 1
    description:
      Panel control input enable, active high. Second on, first off.

  lcd-5v-gpios:
    maxItems: 1
    description:
      +5 V supply enable, active high.

  lcd-nv-gpios:
    maxItems: 1
    description:
      Negative supply enable, active high.

  lcd-9v-gpios:
    maxItems: 1
    description:
      +9 V supply enable, active high. Last on.

  port: true

required:
  - compatible
  - lcd-on-gpios
  - lcd-pci-gpios
  - lcd-5v-gpios
  - lcd-nv-gpios
  - lcd-9v-gpios
  - port

unevaluatedProperties: false

examples:
  - |
    #include <dt-bindings/gpio/gpio.h>

    panel {
        compatible = "hp,ipaq-h3900-panel";

        lcd-on-gpios = <&asic3 22 GPIO_ACTIVE_HIGH>;
        lcd-pci-gpios = <&asic3 23 GPIO_ACTIVE_HIGH>;
        lcd-5v-gpios = <&asic3 21 GPIO_ACTIVE_HIGH>;
        lcd-nv-gpios = <&asic3 19 GPIO_ACTIVE_HIGH>;
        lcd-9v-gpios = <&asic3 17 GPIO_ACTIVE_HIGH>;

        rotation = <90>;

        port {
            panel_in: endpoint {
                remote-endpoint = <&lcdc_out>;
            };
        };
    };
```

## Documentation/devicetree/bindings/dma/intel,sa1100-dma.yaml
```yaml
# SPDX-License-Identifier: (GPL-2.0-only OR BSD-2-Clause)
%YAML 1.2
---
$id: http://devicetree.org/schemas/dma/intel,sa1100-dma.yaml#
$schema: http://devicetree.org/meta-schemas/core.yaml#

title: Intel SA-1100/SA-1110 DMA controller

maintainers:
  - Koen Kooi <koen@dominion.thruhere.net>

description: >-
  The six-channel DMA controller of the SA-1100 and SA-1110. Every channel
  is a fixed, silicon-wired slave peripheral rather than a general-purpose
  engine channel: "#dma-cells" is the 4-bit DDAR "device select" field
  (0 = Ser0UDCTr ... 14 = Ser4SSPTr, 15 = Ser4SSPRc), not a physical
  channel number. A consumer names the peripheral it wants, and the
  controller picks whichever of the six physical channels is free.

allOf:
  - $ref: dma-controller.yaml#

properties:
  compatible:
    items:
      - const: intel,sa1110-dma
      - const: intel,sa1100-dma

  reg:
    maxItems: 1

  interrupts:
    minItems: 6
    maxItems: 6
    description: One line per physical channel, channels 0-5 in order.

  "#dma-cells":
    const: 1

required:
  - compatible
  - reg
  - interrupts
  - "#dma-cells"

unevaluatedProperties: false

examples:
  - |
    dma: dma-controller@b0000000 {
        compatible = "intel,sa1110-dma", "intel,sa1100-dma";
        reg = <0xb0000000 0xc0>;
        interrupts = <20>, <21>, <22>, <23>, <24>, <25>;
        #dma-cells = <1>;
    };

...
```
