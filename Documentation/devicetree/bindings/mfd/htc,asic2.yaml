## Documentation/devicetree/bindings/mfd/htc,asic3.yaml
```yaml
# SPDX-License-Identifier: (GPL-2.0-only OR BSD-2-Clause)
%YAML 1.2
---
$id: http://devicetree.org/schemas/mfd/htc,asic3.yaml#
$schema: http://devicetree.org/meta-schemas/core.yaml#

title: Compaq/HTC ASIC3 companion ASIC

maintainers:
  - Koen Kooi <koen@dominion.thruhere.net>

description:
  ASIC3 is a companion ASIC found on several HTC/Compaq-designed PDAs and
  smartphones from the mid-2000s (HP iPAQ hx4700, h3900, h4100, and
  various HTC WinCE phones), hanging off a static-memory chip select as a
  16-bit VLIO-mode MMIO device. It bundles a 64-line GPIO block that
  doubles as its own interrupt sources (banks A-D, 16 pins each), an
  SD/MMC host, a DS1WM-compatible 1-Wire master, a 3-channel LED blink
  controller and an SPI block, behind one flat clock-gate register and a
  single upstream interrupt line.

  This binding covers the chip core only (register access, IRQ demux,
  gpio-controller, clocks) -- individual sub-blocks are described as
  further compatible strings on child nodes as their own drivers land.
  The LED block is the first of these -- see
  Documentation/devicetree/bindings/leds/htc,asic3-leds.yaml. The SD/MMC
  host (drivers/mmc/host/tmio_mmc.c) takes its registers and interrupt from
  the second "sd" reg/interrupts pair below. A board that needs to give it
  a firmware node, for example to supply "cd-gpios", describes it in the
  "mmc" child node. The 1-Wire master is the "onewire"
  child below.

properties:
  compatible:
    const: htc,asic3

  reg:
    items:
      - description: The chip's GPIO/core register window.
      - description: >
          The SD/MMC host block's register window -- a second, physically
          disjoint chip-select window on hardware that wires ASIC3 this
          way (e.g. hx4700's ASIC3_SD_PHYS = ASIC3_PHYS + 0x02000000, a
          separate 32 MiB static-memory alias, not an offset within the
          first window).

  reg-names:
    items:
      - const: core
      - const: sd

  interrupts:
    minItems: 1
    description: >
      One or two entries, positionally matched to "interrupt-names"
      below rather than fixed by index -- a board may supply "core"
      alone, "sd" alone, or both together (in either order). The
      descriptions below assume the common core-then-sd ordering.
    items:
      - description: >
          The chip's single upstream interrupt line, active-high
          edge-rising, chained through this node's own
          interrupt-controller domain. Boards that use no ASIC3 GPIO as an
          interrupt source leave this line unwired; the node then has no
          interrupt-controller properties.
      - description: >
          The SD/MMC host block's own interrupt -- unlike the first
          entry, this is *not* a hwirq inside this chip's own domain: on
          hardware that wires ASIC3 this way, it is a raw SoC-level GPIO
          IRQ (e.g. hx4700's PXA GPIO66, nSDIO_IRQ, active-low),
          requested directly by drivers/mmc/host/tmio_mmc.c.

  interrupt-names:
    minItems: 1
    maxItems: 2
    description: >
      "core" alone, "sd" alone, or both together -- a lone SD interrupt
      with no core interrupt is a real, valid board configuration.
    items:
      enum: [core, sd]

  reset-gpios:
    maxItems: 1
    description:
      Active-low chip reset line, if the board wires one up to a discrete
      SoC GPIO.

  clocks:
    maxItems: 1
    description:
      The SD/MMC card clock, on boards where it comes from outside the chip
      (on the iPAQ h39xx it is generated by the ASIC2 companion chip).

  gpio-controller: true

  '#gpio-cells':
    const: 2

  interrupt-controller: true

  '#interrupt-cells':
    const: 2
    description:
      Cell 1 is the hwirq number -- 0-63 are the flat GPIO block (bank *
      16 + pin, matching the gpio-controller's own offset numbering
      exactly, so a consumer's GPIO and interrupt specifiers for the same
      physical line always agree), 64-69 are six fixed-function block
      interrupts (LED0, LED1, LED2, SPI, SMBUS, OWM, in that order). Cell
      2 is a standard IRQ_TYPE_* flag; the six fixed-function sources
      accept only IRQ_TYPE_NONE, the same restriction the driver enforces
      (unlike the GPIO half, ASIC3's fixed-function sources have no
      trigger-type register at all).

  htc,gpio-default-output-low:
    type: boolean
    description:
      The board leaves no GPIO line of the chip to float. Every line that
      is not a GPIO hog is a GPIO output driven low from probe onwards,
      instead of an input as after reset; consumers and hogs then set the
      lines they use. Boards that wire unused lines to nothing, or that
      need a supply enable held off until its consumer claims it, set
      this.

  led-controller:
    $ref: /schemas/leds/htc,asic3-leds.yaml
    description:
      The 3-channel LED blink controller, if the board wires it up.

  onewire:
    type: object
    $ref: /schemas/w1/dallas,ds1wm.yaml#
    unevaluatedProperties: false
    description: >-
      The chip's own DS1WM-compatible 1-Wire master (drivers/w1/masters/
      ds1wm.c). Its register window and interrupt come from
      drivers/mfd/asic3.c's own mfd_cell, not from this node; the node
      exists so a board can describe this chip's register stride,
      interrupt polarity and post-reset recovery delay -- the same shared
      binding every other companion ASIC in this family uses -- instead
      of the driver falling back to that file's compiled-in
      asic3_ds1wm_pdata. The stride follows the board wiring: on the
      hx4700, where the chip sits on a 16-bit bus, it is 1 (registers
      two bytes apart), not the 2 the HAMCOP/SAMCOP/ASIC2 integrations
      use.

  mmc:
    $ref: /schemas/mmc/htc,asic3-sd.yaml
    description:
      The SD/MMC host cell, if the board needs to give it a firmware node.
      An empty node is valid and leaves card detection to the host's own
      register bits.

patternProperties:
  "-hog(-[0-9]+)?$":
    type: object
    required:
      - gpio-hog

required:
  - compatible
  - reg
  - reg-names
  - gpio-controller
  - '#gpio-cells'

dependentRequired:
  interrupts: [interrupt-names]
  interrupt-names: [interrupts]

allOf:
  - if:
      required:
        - interrupt-names
      properties:
        interrupt-names:
          contains:
            const: core
    then:
      required:
        - interrupt-controller
        - '#interrupt-cells'
    else:
      properties:
        interrupt-controller: false
        '#interrupt-cells': false

additionalProperties: false

examples:
  - |
    #include <dt-bindings/gpio/gpio.h>
    #include <dt-bindings/interrupt-controller/irq.h>
    #include <dt-bindings/leds/common.h>

    companion-chip@c000000 {
        compatible = "htc,asic3";
        reg = <0x0c000000 0x1000>, <0x0e000000 0x1000>;
        reg-names = "core", "sd";

        interrupt-parent = <&gpio>;
        interrupts = <12 IRQ_TYPE_EDGE_RISING>, <66 IRQ_TYPE_EDGE_FALLING>;
        interrupt-names = "core", "sd";

        reset-gpios = <&gpio 71 GPIO_ACTIVE_LOW>;

        gpio-controller;
        #gpio-cells = <2>;

        interrupt-controller;
        #interrupt-cells = <2>;

        led-controller {
            compatible = "htc,asic3-leds";
            #address-cells = <1>;
            #size-cells = <0>;

            led@0 {
                reg = <0>;
                function = LED_FUNCTION_POWER;
                color = <LED_COLOR_ID_AMBER>;
            };
        };

        onewire {
            compatible = "htc,asic3-onewire", "dallas,ds1wm";
            dallas,bus-shift = <1>;
            dallas,active-high;
            dallas,reset-recover-delay-ms = <1>;
        };
    };

  - |
    #include <dt-bindings/gpio/gpio.h>
    #include <dt-bindings/interrupt-controller/irq.h>

    companion-chip@14800000 {
        compatible = "htc,asic3";
        reg = <0x14800000 0x2000>, <0x14000000 0x2000>;
        reg-names = "core", "sd";

        interrupt-parent = <&gpio>;
        interrupts = <4 IRQ_TYPE_EDGE_FALLING>;
        interrupt-names = "sd";

        gpio-controller;
        #gpio-cells = <2>;
        htc,gpio-default-output-low;

        rs232-on-hog {
            gpio-hog;
            gpios = <18 GPIO_ACTIVE_HIGH>;
            output-high;
            line-name = "RS232_ON";
        };
    };
```

## Documentation/devicetree/bindings/mfd/samsung,hamcop.yaml
```yaml
# SPDX-License-Identifier: (GPL-2.0-only OR BSD-2-Clause)
%YAML 1.2
---
$id: http://devicetree.org/schemas/mfd/samsung,hamcop.yaml#
$schema: http://devicetree.org/meta-schemas/core.yaml#

title: Samsung HAMCOP companion ASIC

maintainers:
  - Koen Kooi <koen@dominion.thruhere.net>

description: >
  HAMCOP is a Samsung-designed "SAMCOP"-class companion ASIC found on the
  HP iPAQ h2200 (h2210/h2212/h2215), hanging off a static-memory chip
  select as a 16-bit VLIO-mode MMIO device with a single upstream GPIO
  interrupt line. It bundles a NAND flash controller, an SD/MMC host
  (SDI), an ADC + resistive touchscreen front-end, a DS1WM-compatible
  1-Wire master, a 5-channel LED blink controller, a 32-line GPIO block
  (offsets 0-15 double as 16 of the chip's own interrupt sources), and
  16 KiB of on-chip SRAM.

  This binding covers the chip core only (register access, IRQ demux,
  gpio-controller, clocks); the sub-blocks are described as child nodes.

  The on-chip SRAM sits at chip offset 0, below the register window, and
  is the second "reg" entry rather than part of the first: the CPU resets
  into it, so it holds the board's boot code and is owned by the board's
  suspend/reboot handling rather than by the chip's register-level
  drivers.

properties:
  compatible:
    const: samsung,hamcop

  reg:
    items:
      - description:
          Register window, from chip offset 0x4000 (immediately past the
          on-chip SRAM) through the end of the chip's 1 MiB address window.
      - description:
          The 16 KiB on-chip SRAM at chip offset 0.

  interrupts:
    maxItems: 1
    description:
      The chip's single upstream interrupt line (ASIC_INT_N), active-low
      falling-edge, chained through this node's own interrupt-controller
      domain.

  interrupt-controller: true

  '#interrupt-cells':
    const: 2
    description:
      Cell 1 is the hwirq number -- 0-15 are the GPIO A/B bank pins
      (identity-mapped with the gpio-controller's own offset numbering
      below, so a consumer's GPIO and interrupt specifiers for the same
      physical line always agree), 16-25 are ten fixed-function block
      interrupts (DMA, TICK, ALARM, ONEWIRE, SDHC, ADCTS, ADC, WDT,
      KEYPAD, NFIF, in that order). Cell 2 is a standard IRQ_TYPE_* flag;
      hwirq 0-15 accept any of level-low/high or rising/falling/both
      edge (the hardware's own GPAINT/GPBINT trigger-type registers),
      hwirq 16-25 have no such register and accept only IRQ_TYPE_NONE.

  gpio-controller: true

  '#gpio-cells':
    const: 2
    description:
      32 lines across four 8-pin banks (A-D). Only banks A/B (offsets
      0-15) are also hwirqs in this node's own interrupt-controller
      domain above; C/D (offsets 16-31) are plain GPIO with no
      interrupt capability.

  nand-controller:
    type: object
    description:
      HAMCOP's NAND flash controller. It has no interrupt resource; the
      ready/busy line is polled.
    properties:
      compatible:
        const: samsung,hamcop-nand
    required:
      - compatible
    additionalProperties: false

  mmc:
    $ref: /schemas/mmc/samsung,hamcop-sdi.yaml
    description:
      HAMCOP's SDI (SD/MMC) host. Card detect is a board GPIO and the slot
      power a board supply, not HAMCOP registers.

  led-controller:
    type: object
    description:
      HAMCOP's 5-channel LED blink controller. Each channel the board wires
      is a child node whose reg is the channel number.
    properties:
      compatible:
        const: samsung,hamcop-leds

      "#address-cells":
        const: 1

      "#size-cells":
        const: 0

    patternProperties:
      "^led@[0-4]$":
        type: object
        $ref: /schemas/leds/common.yaml#
        unevaluatedProperties: false
        properties:
          reg:
            description: LED channel number.
            maximum: 4
        required:
          - reg

    required:
      - compatible
      - "#address-cells"
      - "#size-cells"
    additionalProperties: false

  adc:
    type: object
    description:
      HAMCOP's shared ADC/touchscreen front-end.
    properties:
      compatible:
        const: samsung,hamcop-adc
      "#io-channel-cells":
        const: 1
        description:
          Index into the driver's channel array, x=0, y=1, z1=2, z2=3,
          ain0=4, ain1=5, ain2=6. The driver installs no fwnode_xlate, so
          IIO's generic single-cell translation applies.
    required:
      - compatible
    additionalProperties: false

  touchscreen:
    type: object
    $ref: /schemas/input/touchscreen/resistive-adc-touch.yaml#
    description:
      The resistive touchscreen panel wired to the four touch channels of
      the ADC block above. It is a separate consumer node because it is
      board wiring, and because the phandle reference makes the consumer
      defer its probe until the ADC driver has registered, whatever the
      module load order.
    unevaluatedProperties: false

  onewire:
    type: object
    $ref: /schemas/w1/dallas,ds1wm.yaml#
    unevaluatedProperties: false
    description:
      HAMCOP's DS1WM-compatible 1-Wire master. The same core is embedded in
      several companion ASICs, so its properties are described once, in the
      binding referenced above, rather than per ASIC.

required:
  - compatible
  - reg
  - interrupts
  - interrupt-controller
  - '#interrupt-cells'
  - gpio-controller
  - '#gpio-cells'

additionalProperties: false

examples:
  - |
    #include <dt-bindings/gpio/gpio.h>
    #include <dt-bindings/interrupt-controller/irq.h>
    #include <dt-bindings/leds/common.h>

    companion-chip@4000 {
        compatible = "samsung,hamcop";
        reg = <0x00004000 0x000fc000>,
              <0x00000000 0x00004000>;

        interrupt-parent = <&gpio>;
        interrupts = <5 IRQ_TYPE_EDGE_FALLING>;

        interrupt-controller;
        #interrupt-cells = <2>;

        gpio-controller;
        #gpio-cells = <2>;

        nand-controller {
            compatible = "samsung,hamcop-nand";
        };

        mmc {
            compatible = "samsung,hamcop-sdi";
        };

        led-controller {
            compatible = "samsung,hamcop-leds";
            #address-cells = <1>;
            #size-cells = <0>;

            led@0 {
                reg = <0>;
                color = <LED_COLOR_ID_AMBER>;
                function = LED_FUNCTION_POWER;
                linux,default-trigger = "default-on";
            };

            led@2 {
                reg = <2>;
                color = <LED_COLOR_ID_BLUE>;
                function = LED_FUNCTION_BLUETOOTH;
            };
        };

        adc: adc {
            compatible = "samsung,hamcop-adc";
            #io-channel-cells = <1>;
        };

        touchscreen {
            compatible = "resistive-adc-touch";
            io-channels = <&adc 0>, <&adc 1>, <&adc 2>, <&adc 3>;
            io-channel-names = "x", "y", "z1", "z2";
            touchscreen-x-plate-ohms = <400>;
        };

        onewire {
            compatible = "samsung,hamcop-onewire", "dallas,ds1wm";
            dallas,bus-shift = <2>;
            dallas,reset-recover-delay-ms = <1>;

            battery {
                compatible = "maxim,ds2760";
            };
        };
    };
```
